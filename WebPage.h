// -----------------------------
// HALAMAN WEB UNTUK SETTING JWS

char setwaktu[] PROGMEM = R"=====(


<!DOCTYPE HTML>
<html>
<meta name='viewport' content='width=device-width, initial-scale=1'>

<head>
<title>JAM WAKTU SHOLAT DIGITAL</title>

<style>
  body {
    padding-top: 20vh;
    font-family: 'Open Sans', sans-serif;
    text-align: center;
    background-color:#fafafa;
  }

  h1, h6 { font-weight: 300; }

  h1 { margin-bottom: 20px; }

  .form-switch {
    display: inline-block;
    cursor: pointer;
    -webkit-tap-highlight-color: transparent;
  }

  .form-switch i {
    position: relative;
    display: inline-block;
  margin-right: .5rem;
    width: 46px;
    height: 26px;
    background-color: #e6e6e6;
    border-radius: 23px;
    vertical-align: text-bottom;
    transition: all 0.3s linear;
  }

  .form-switch i::before {
    content: "";
    position: absolute;
    left: 0;
    width: 42px;
    height: 22px;
    background-color: #fff;
    border-radius: 11px;
    transform: translate3d(2px, 2px, 0) scale3d(1, 1, 1);
    transition: all 0.25s linear;
  }

  .form-switch i::after {
    content: "";
    position: absolute;
    left: 0;
    width: 22px;
    height: 22px;
    background-color: #fff;
    border-radius: 11px;
    box-shadow: 0 2px 2px rgba(0, 0, 0, 0.24);
    transform: translate3d(2px, 2px, 0);
    transition: all 0.2s ease-in-out;
  }

  .form-switch:active i::after {
    width: 28px;
    transform: translate3d(2px, 2px, 0);
  }

  .form-switch:active input:checked + i::after { transform: translate3d(16px, 2px, 0); }

  .form-switch input { display: none; }

  .form-switch input:checked + i { background-color: #4BD763; }

  .form-switch input:checked + i::before { transform: translate3d(18px, 2px, 0) scale3d(0, 0, 0); }

  .form-switch input:checked + i::after { transform: translate3d(22px, 2px, 0); }
</style>

<style> body { width: 97% ; text-align: center; } input, select, button, textarea { max-width: 100% ; margin: 5px; padding: 5px; border-radius: 7px; } meter, progress, output { max-width: 100% ; } h1 { color: grey; } .note { color: #555; font-size:1em;} .info { background-color: #eee; border-radius: 3px; padding-top: 17px; margin: 5px;} .tombol { background-color: #ccc; margin: 20px; padding: 10px; border-radius: 10px; text-decoration: none;}</style>
<style>


.ws table {
  font-family: arial, sans-serif;
  border-collapse: collapse;
  width: 100%;
}

.ws td, th {
  border: 1px solid #dddddd;
  text-align: left;
  padding: 8px;
}

.ws tr:nth-child(even) {
  background-color: #dddddd;
}

</style>
</head>

<body onload='updateData()'>
    <table width='100%'>
        <tr>
            <td>
                <!-- <img width='100' height='80' src="data:image/png;base64,iVBORw0KGgoAAAANSUhEUgAAAMgAAACHCAYAAABTVhYnAAAABGdBTUEAALGPC/xhBQAAACBjSFJNAAB6JgAAgIQAAPoAAACA6AAAdTAAAOpgAAA6mAAAF3CculE8AAAACXBIWXMAAA7DAAAOwwHHb6hkAAAAB3RJTUUH5QQMATEqKS+dugAANXlJREFUeF7tnQm4ZVV1518PSQ9p2+50utNtd9KDdhtth44oqIg4ocU75z5mRIgBASlQGVRASgUKCkQEGQSh6t03VDGoiFFR2igaDaJGJYgiihgcoRVt2zbGGOKQ5P/7r7Pv3ffce1+9V/Wq3iPs//ft707nnmGfNa+115koKCgoKCgoKCgoKCgoKCgoKCgoKCgoKCgoKCgoKCgoKCgoKCgoKCgoKCgoKHiI4eo1/3JifvJ/TZx55j9svikoKOhhtn7GxEy9eaL7/F9vvikoKOihW58xMV3dr7FH801BQYGxqf6NiW71x2KSv52Yqc5qvi0oeAhi0zG/MnHpmn/iMb/nP/XrdKcWc/wwGKT+5MTM5H/2b+l3xjsP+kfNHgoK/h6jW+0iLXGpxtvEDNfr83vFGHdMTNd/YwbpVj/V+4/p/bv1/jq9XqNx2sRV+/27Zg8FBX+PcflB/0KMcayI/1vBEFsbMr1mJp9ZNEjBQwd/O/EPRPTPFqN8XAzwy5GMMV3/RL9vmpjf5780/yooeIhhvv6dYJI2c1S/EOO8ydqmoOAhi03Pe7iY4aYhBgmtclqzVUHBQxSb6qeIQf5Pwxg/0vuv6PXn/jxTvd/Z9YKCBxU21f984sw9/3HzKYBPsS2YqV9mhpiuvzgxW/3+xMzUo/X5jWKUH2h8e6LbeUKz5fbjqr1+bei8CwqWHTNTzxQxH2f/gPwEJSJb9v4fza+Lx3UH/jMxw7Q0xbUTc3s/vvl2YuKdB/2q9r+fo1cwzbaA/Mlc5znOp4CZvZ+s83ylzv1h/lxQsMPQrXYVUf+ZRtcEDiHjbC8VmE+zU8+bmN/nXzXfDGJaTDe3z9O3qXiR/+DDdKtbdJ5n6fVzjogVDVKwwzFXP0kE9w0RYDjUq5XwYOTp+rv986wusnYqKNghwJyaqaYiLJvnLqoPyVd4VLPV1kHCD/OMzDg+x2b5GZhps1O7SRM9d2KzCHu+s7t/w3RDw+D3LMXPgWG79dEaP8rO8//qPC8oeZWCHYNrq38tQn6JGOQyjT91achMdb/e3z0x09k4sXG//9BsOQz8jenOf238l/3sD8yJgGc7G/T+5drHmXr/ar0/TeN1en+Sxul6f4J+e5WO89KJuWpSBL67y+Fh1nFwErLeV0zxab3eo9cH5PD/f71/Z2Nu7brNQYWCgkVhtnOwzZfZzlEi+P8mX+HxE1eIgXJ8TFJ8fvLfWyt0O6/wtjP1xXa8Z+oLzRjBEMEsM1MnatsX67eTxXBHaPv1zX8u1ND3nUu1n8P1etbE/NRB0jS7TMyu+bfN0fpAQ6HRZqce6zFTf1CMcdPEln3/TbNFQcEOhgmvutxl6m1g52PGzFYHTsx11onIj9O4IDSGGALinq+e5dWDaB1MLZtce/2aB+YUWgKCxsyC+UIjHBoMJU0DE8FAZqipaiSjJMxMHSKtsa6sVCzYeUgmU26qQIBojLn6hSLeMJEg5PnO8Xo9QAT/GPsT21p0iFnF/vFVMLls7nUu0nGkxWSKzXfWmMHa2HTQw8Vkv9V8KihYAcAwhGxtKoloeZ2T7zBX7WFtsDWmgLkwyRhsuzUfIZlRXTEFPop9GZluMCZOf0HBqgFm0pzMn5n67MbXOFUS/RmW3KOACYZEZ2ktRN2VU96t3qz/b9LrjF6v0HdvNOFPY6bVT7IpN8pEglGm1/wnO/BznfP0v7X2Zbqd/fVakoIFKwyIl7Uds/W5Ygx8jYNtBrUBIc9V/12/HyUi3iIT6QsOu05Xf63PTRi2NbyAqvqp3t+n11uCiSarkQunWKWIRpmDQcQoZrzqcDny/7HZ4qEJNDHzjkk6M/Xk5tuCbQKTSUQKJ3lrMMHXTxExnqNxhJjk9SHpRag5+Bw+w0UanxWx3yrC/+aCjDFyVH+h16/q9Rs61se1rxNH5jPIzs9VLxDDvkEMs07bHTaxpf7t5tetg23HZfYfTLBm7fxPzdkZGndo3n5pAVMCFdsBIkHd6q2OUC0EE71MKAjQJpUcZBz2NrqTjzFjdOsvatygcaiY77d1jF30/t0OExN+7VZ/ooE2+YG+F/PUP9H4msbH9Pv79BsrD2e9v65MqVim+z39fqu+XzsUvuX8YN45m3uYbi9bVHIQAdGtTtVxfq/55sEHzFcvaa7P19zcrRECZrr+f3p9SbNVwaIBcXlCXUW7VhP5XRHI/s2vo9GtnmVTCeKb7bxoyKRymFbmDdqiW31E2xzsdR+AXElX5th0/Rl/j8TfvO8jxQjvsCaKvMXV+t8G/4eiw2AKFlWdZunuGi79l2SlTbDqPXr/tKGIGuFhBw0ICZN8lHZcCOzXDFl/1CHo2eqJZsoHQ/2WgyT0Fasu19x+U9eQGOP7+u5tnkO2KVgiIG6cYmeckeLOjkui15fouxcPmRsk52bqU0TMZ2m7w5xdzzEz9Qj9fpn28zXt7/SJKzJ/wXmNaqOP05XWSbmLyHNc7/9C2C6Brz6g1+dq7Ov9xDqRn2lMu0IXf4cMfiKErs5/pjpyKMMe+z5F2/+e/9NmZphqZup3fQwYM7TYz7Svb2l8Vkyy37KbJZw/RZiLMWW3BvJH3c5eOv95nfd3svm4T+fflWZ/zsjQd8ESgPnRrT/Ym1yWu87IvJnt1AMEh8NLcg7tgFk1zBxoobdrfF437VPax8mWxBCCb2R1gcbnNDbo5l2u8Qm9l5nmCBbaYH0QKeaVfBSbBdVfxvnIFJup7tTnb+tVDmd1nt7jwCMl/0rvv6Ht9Ft9ps5jMHoVtV7najRJSmmlHDb7rNX6hY3T1Y99nOXSHtZoOMsIF1/rNyzxtxUIrunOPtrXO3WuMHXDGNXXdd6X6vunLViOU7AEMJFu+dmb5LuG/BAIfJ7kHJEqmSvt6FCYRv9b40JLyLCDT9HrvLTNnF5nTPDhU/yJiT6Ox+pBNENz7BEjtr25OUdCwh/RfrRPmXCur5Jptom17Tq/8HfeaHMph0v0qeni/KYqO7E5+OzOjk3roWDOZzW/bjtgsJnqcdrXeu1T55aKPKmG1hwtFUTw8OW69Y3a358350q07y5d2xtCILUCJVwb2rt9zQWLBJOKxgiHmvUdX/JNTeAmUxoCcTkrLpMkh4sQxRz0r0oOs00XTCRJs1wyb40ZRo+fa18/1H6+r3O7U+/FFPUf6DyeOWRXY25gGlGUmP9mxx2JK2bCeW8v8PL5Sis5/CwmpH4LrdImtsXCuZ76KTpfaU2ib821UDSJz9StO0vaNwIpqpM/qv//ZbM/hMvtOufXhq80xhRkMRravPgg2wjXO9VPsoTBPOlWr9DYtfk1bGabLg7nHtB8GyBLTl6DKFVavYe2wR8IprlXIyf2pQ3MJ/wBfBKcdBjZjvfUIUPnktCdXKNtP6/fjx0gGkzCKIFZLyY5fMA2x+yieHJu8un+jO9EFcBS7XeIkASok51536/qe7qOa/U6OaTdxgGmtfCpTtTAL3yg2d8D/sz3BB7y4MQocM3TuraCZQKSLTmQvBIxiijQSQNOe5gPkl6YP1PP1qjCXIORJOkdCrZp0XRM3IYR7X8kMWVW4WB7sVa91pn4mc5r7D+MQkhb+UItMwlTEP8pfJI9e8SFcICxtxUIlunqBTrmFr3e73OPca+YhQqBZ/XmdGvgXNwOyXN7e8wB+/I8/JHeH73oBCj3yw58Z/fmm1WObuc3NVH9Clirdkvol5nIVhvQLlGJu1bEtVvzbQATijUXECwOcLdzlYkYf6NbvctEHG1D+wS/rQNNktanJ+fT5SX1C/2+DSQ5OR00Tx65gqnN8GT0pUXGlcMsFoStibQRhYtcQzrfr+n14onZyd0W7SwjmKZl7mLa4VP0BQuLvsgjvXAo57M1uNKheu/ExheMX6uz08FN4MRyaQsjYHcSz2f9QwLrrqOruezJal3z7eqAzQ5Xyr5ExPSKAZvZ+ZP63Zr8s2y6UN7RFVFExvzruk4c9rN1k+U3NESzvYOwZb5kFkHDXI4quQcRNfqM5vXUATPEpfhyyPGpaOywNRNlFLwasjrM15k7yzP1lzUX5ziHQuHlYsA8E3XCXyMK1btmwuHVdfr+SO3vefpO9ONjvtgRLDq+tCNybUx3XqT/ydycfLa3b6/ZWRG45qi+ZGCNgkOp1W2+8NnOm3o3BdVrCVH9UhM8bCfCbNQYjSOCHQkTWOesIKbMaQeEegmF2v9wxOpVep9s5B00NH/MIyUUSH78C0w/Mt9tIud3fBQcdkeP5MQmsO0cxDZ15MScxlL8DAoju9Ux2vfH9Jo5yw5fr7NptJS8CSYi/kq/NxjjOzrvOdEJxK3rk2Pu3308ghwaNrfwzS5Y8IFD0JRD5t7/3TrWc5tfVhCRRT5jYKJYy00JBRNAOXj6DTs42v7/TN8f4e8AkpKmag5LOoT3suaX5UVOWG0ic3LNq/+O1bn07eeQnjfp+0/qWr+k6yJzy9LWdIOXf7h2q7qlOZ/ne17Cv+HYt/Zscl5Dym7W7/PePsLCZw3cD4ROMD9h44XDrcwLznBX2gqTsl9HJmfZj2o43s70tmCmc3yzLw0nJy/Xue0ec2zGWbhmzTmgBUpIMCdjG7a/d6vXusNhdUkSrBVhCU5Osf+32BEDdC0PBnnASSzboSkKUt/X/OcOq1iAPRthWZobbHulqrPavrFPNeG4GYMYFI0F8JWckOtcOjGvbXJEmcftksC/q21wJAdv2o4ZhDTP9flyntZeMkHcfqj+A/12aHMub9fny3RtVc+/YPtu9akBIg6zplneq3lvCwfAPYr8zut1/z7fv3+W3pTQHKX/PqLZetswUx2ifZI4JIm6S8+MpY/XoLO/wJCvle4b18y9S4j7eJ7m4Fq9HrZof2iHwSpT0pUbmYOkWXK6YKDEIEiLyIQijS7Wb3PaDrtdGkUTh+mC2mbibPdXb9L4lrb5c/3vJh2v348KKU9J89bCiPwOk4a6ng0p6zKFu3umiNd7kw8gItWEbwGE1a2u8k2J7Pi8r4vchNdwVHf2rnO5h7P7kuTTOj5+Duc+U/+h3n9C470aJ5pp20RgrYJJ1JK0RNli+e6xA+Ywcx3O7Xk61ley6/mRvnu/xiGa6+UxeQkmcH6JwBMIVYcJq+M6uSgh6gLNpA3yeYm2S0TSbHEQMJApmACt5b7bigJnK0oeLtMNeLlrbuL7PoOY43MTq1cqgJSUHc/aBwoH5cBvmny63l8cnxt7cnByzu5JP8J/dpCrg/yZGw1xtx05fo/ycf6P2o0eV74hujHsz+u8bf+u7TEzgIFchNhZo//tqvf3+pxwBkGEJymOy9oCLdNwToQEHgKCLiXOKxxuST4/dYiPPw7kcfCX8rlw9LDzWjnqcqqbyoEoEZfwaObEw5rqHRpTA4GXHYnZem8dV/fIguAM0wlahRq29CSu/vmtNz0Rho+HD0Fnb1mdNVg43c6W6sRRyUgof4/92iszuNJhtygZ+LC380XBGHI4Xd3KszMoNqu/698xL2aqc+L/+ZA0RTogicLUgOivtzbhpjvzKmLOwXEhNhOciwe/1OwrQqLsLwr8ThKjDIaeOT/3wRKjmEB9Hjjnr9MxaUR9oL6/XK/jbGeZZvYPpGmSybKUoTl0kaI0adJsjkqJSTbtMj4zjaa2FpHvkQCz0PSBKF1azx61ZOl4jbM89bwFcyQIlNy/WQ5EoeYHzRi5+RcmWb/XF7Tm/EvnCfrc9wP9fWef5l+rCJH5ZGEQJ0pFaySqUpNmnzz2bH2zfqPYDo1BBOuvdJOP88UigYmpm8jImMpXILOLdDMTOJoRE0H9DbC5U98Y+8d2xXSTmdd1acOVPdsWhANIb6tTmnDtWm+TIlVcg9vrIHWz6E/4KpSjvFvjLT7ndB7hE4QJMED4XJttaSIvCIg32k52wq+6Tb99W99lzd0WGAgRCBYfLCcaQpfM3UKmpX0umWE8CzGBfcyxNBfTdurIqAqgDARnWfPDHLa1bxuOljVNKZYT+DZ5O1cEHibiQBhYA1pxMjCrI+v/9trm36sIVnWTu+lGHOXXvimFagwG8XDJN0tPT9SFfVefIR5qdn7UEN5H9duRnqgckRk9Xb/TDO0HPefdvkEm/dAMSKEourtrYvOaR3q7BLZPRAbz5AxkM8m27LEikr7D52yxy0fQGIusqfJ1yVdwcSFd3MX4YvJptKMcbGtRR/2+E+dKlMhPlmIb6qLYD/N2gwhR2k4M62uVj5Tsaj5TfrJQ4zrMxLimk5tvAgQg0CCUnlwrRmP/5DDy+RgH1quwLCAE2S0LHn97EPfjCs1L5Fv6c/vHthLCF5RWz35DYK1KDdIGE475EesZ0gUQGny2HU4zSM8kwym7Ud+NdwIt3cUIIS229OxMCCB8lTRB94ugZJKJEYPhRmec22A/lLlbg0ydOGDH4ky6fKN3HYsdd+t6K72iefrfwxD4bMBLQ91g+mS9XhmazeYc2pJixVN65+IQrRzTlCH3tet8ydsshG51nPZ18UACj33NSqvRFWUpBI7gwx9IWpR7h9+2nIigzDE6RmvObXm8vec3ISCikXi2jQQslsKqBSUaXrNgrYDkZBlpqEAkqAsCySNYGjPBrHk4Z6yZABGw+MWmmfdxqyVdDogoJHaaJKRyYwZlocBxgCnJF5B3gVGRynn0wyYeyane/pcwKHcn8QXDpjUhnTnNUzQSCMb/sIj1Rr2PCCDayz6U/u81Is33SHqSaJt1Pgl8bs9HG/FIhXkTVELkTQhnHzFgTm4NmGMRGUvX9z37C1sD9xFGxxLgNTcVE9DUnKuLPZs1L3EMVk/eoms9aigjHiX1FDRiPUgzV5PNL6sQ5mg5ouF4ozmQjuv12jCDifZneqUM/Aa9Etb9uS98FKK+aZ22obsHTuoHRbxPaX7tAwLsMURrkLcYV9gHQgMRtcpMJxKU1WG9MmmkfZiGg/tezAgf5QLtj964kayal92OL5LgKl37XP2wMlEmm1g+boRpOVcWQVGHlZgeX6JdKwYgQEwQM4J8uRQIcfia+rfJ1+iVhOdtGq/WHNZm2ghWjF8/QSjZtV6+Ps7vTb15agNGIAIVKyWv1PayEsxc8hmZE5nCOdO6TL63dgQfFYGFOX7IgjVVEYi4THO9R4/xYOTFmIs7FUjdKBk/VRf1OEs2S9DGeY11wiQTRXBS8ekZ4YSFc4Rj1tF/P6JXbgKlBaePNQVIOobPgdNP04PMZpX0gdgxn9AEbZBPiRvRJ2pGhFMvNXNhFiZzMH673yPffqHh3E39Zb0Pcw8Cz9eWRH6mM9CFxD2uMF8IDmiumFuvvSbIQO6j+f/MFF3nw1wLCfxEfX6x/vtm7ZPgBXMcgiiECK9/49E7P92f0PT4hARaLnaYfZzmhdG9Hl5MNsokRks4qkeTiV7Sd9S8QA/n9bQCzBfry4/U/j+k/588wEALIT9XJ6F1fovRbDsdXFCsYqMk4usDNwJpkKQNdqLzCvo+OZDWQFNk2FlnQYII6TltKbQQMOtiuSpLZrHlYdK/8LFDW8lHaTLAbYQvxA2EcCDkjHB4z7PKbTJyPlESsWmfp1vitiMrCw0c82QKtRkEYHcn2xoQag5JerNzSkTPQuITZWPNxS6eL5egYCrpOmAIomPjQ81LGffq+l9uxmwDPwSmToGYBDSPiwNFnOFXjtrv4AhHf92A1oq1Np/0tfjaxPiLhQVvMrlkzYzTbisGbhgFYkF0n9cFvl+vyd/Y2OP0sPvjQqKbIHVGMs+QzCyy0XskAIQTDQgO0HYv0f5lo0o75RdOKDhNCnkXEo1Rq/SAbtjx/k/c8FOafwRcnuAFSdiv77NZ41B1bv96kO2/1/tJNxJVju80KABGD8+FNGAiqLaJlZDb5VEEifbEFGne158W49Bkga7xT9BYr3O4S/vnuYajpfT2DAc8dKzFAIaxcMIcHrGvhUY8p7HfeSXCtx+O3yXo4vENB/m+bo1ZQkCGP2pNL/911QACoH6HUmtuqjO2MgFS9no6eyJTOHvxnHDfCLSFs+FRtObQKs/aIzeCVGzMA4gX4ieak8oKwiSLSBHS3u09iYBUND54gWzvKF+YlkmQwwk+JyQl7WTLQ7g4vRTzoXEGiZ+OHzeZSVJAAYmPj9PfZty4fSDcPO+OJQsXz7Eoyv/1oh+y99jwRJ2u0XnIyZfJNs7vGjXiWgily9Sjc0p1rfZxvQbE9wnNwZ+1rjcGQmCUQ53DfcWchW8LlhgwL+YU4Wubhw4744gnQpY520rMhtbO9uOoHg30EGgkj2Vair5y0wpt52TswP8+MFB+suJA4ue+AiHAUQxi6Z2khOuhzrCmQELj3KF2wzzKLrY1YEaY0qqdBJe/0wR1flP/pSz7p9JCe9sxhZgoSciBCcFNgqFxTmHmWe/nUDEnic+N2iYqkfuD5N67RagH+zpZVzEYyh4x6Ls79QgzFo4j/bfIFS0EHGdn+umSKJOKNeNe49Eut1hwkKSUGYjgqf9Q+9rL14XzDlG7K2TnFdZm1kjVdRp5NBAG6Vdgj4Lnrcn15P/zQEDpPlhYyk9CcKWQNQwR+R+2/ZF+D03FvbRA8IK01v7ygQlthkOg7uX9mg74PLAd1zNtgbwqQdgt2aM5g1hDcNN8ER/pSWVMJ0Kho6QREs4Ea21Dvc6HrI5Bqq6FECL69S4d96/1Ga1wkt8TW0+IaMxVsW8y7rv8ilfqeZGUGARpBCERgYnEXvtcOA+ZdR3OVTb3OFPLDHi3zuFaDd0oJC3aDqaRlrD5RCfEKR6qQ1kO7YBoA8TCK4oRSRounim4Ts43ymGONuHb0RfD5YBRWBNC3VnSbvblUvmNBxr7OP82ChGOZqlt27zjf/QUPnxsTsK+SrouWgFJG9tsJey8SDOtP+esK9pg2oqQer/iwtv53r/J93PVIa/OzBnEIUCp27iAT/WiIfZh2plTTWSo5FM1AbXeEwXbS9s+z4QM8E+4UVQCe902JhifPeGneZKIjiSgdsMMQ8Ks9XeuZK3PN+Gi4QA3DWkfa6Lzc4oRTEt91xgGqe/RsQ90Vjj8BpmPYmZMCDeBc49fig8/p+9C0y59EDpnVePbfI3kNVL0B0EUlQYdf05gGxawcQ6pasDRpzzHoXPPH1OdI0zkmOP8XNx4jjL5BcwaC0GX7MScQQcWRn4OZN4EbqHxc23P2pw3aFztV67ZGq0x3QeGmIZ5X/Gy9zZwvhPB5wwSmkIq3Rdwh+P1QdiYEXFRnkBHkaZ6BDsO4eugdUQokoTY695PB1OFXArmRl+D9EO3P5QUjXAgCTgIxp3SW6UuqdAxndtiB2aiTSQekeAuhlTXQrAyL10mQdz/e2bg8Uy28IAxkMCJKXJEbuHDQ9n2eDwcFcEn9SRrmFn9yBxm66hcAtt7HUeeOxLBYhEQYk2BjFGI6CX1U40Q1D0jLE2haoSY0/4WMQjmVGeZdvJom2vsmsDQ4EBjHdpstQLA/2irMWzLGdvtgwwCJ0/Ti9Ynfo9uDivdkPb5hd3giVsM7AsQpiWi42LFU2MflpJiEiROFsWK5CDEdaedPYAEjXUSZ5uwciBxnantndsqGjIRx/kJvk6ZknnUj22jY8slmrd9+mavNGfSCBYe0tJt2EcgsZj5Zs6zyMQZZU5xLIRblNPTcQW/M7vHmMk2idtdYBBog/7Q6AGTymQVcycg3Gzijdh+WsdL/ZJ3KmwyOUw6uIabxmuurPXJ9cO81AW55Nwnfp8kII8KwNlrLqT+skyohUsocvD/uFGsepvUvug2iBSU+vV7JvLiZtvHatumzke+ClEwABHhg8AkJBZzIJ17Pks6R2zbRgPk3y/bwMml6rdlUw8N+XDJF8vhLDpOcmZaArYNLUkPr+f7O4h7wDRBOk9Wvm7MTEeIIDz9byBJ6nMjz7Sr7xfmKKavGbA6Sfu8TL9JU0ozxXw1/2uOQRAlWsDekf2Gg44veJpGv/ncggN/MIsMwoyDGl8aDt9MWm5FOp1QpoBN2q6ViexvE61A0jUMYkkkCRYn/307yP2oFuPcrYYXsa8TYdg8sHNHOPYwDdYP4CyyhmN/vceRu81OXHQy53wkoaRpcqCJkKSznWO8/xz5gqsY2MHn6Nz30PuLdUPaEa9FDp0H/40GBbf5JkZVr3wXt8PJ12qMGneMtPntj5A7yXIMILT1WTqGNKXMWkDisps1UAjzlsVTBBTeqn3hJ2n+hq4RwoNhyJhz/ggLLIYHYh8D2/YHxIuvElErqppTruzbNn8TCPWPqnQYNfBJ0vWEL5L7Uw/omo+3RbIifgiRGDRIG5RVO8fBSbYKB90HySevCWV9QiJcXQyNExZChII3aDKP92dMoLQazktQ5bfETWDdM4u5GvMoi46FfxBlGgnObXi13VlDdnvYz1FE2B8390zL6JLeSEln3ak0FXGTd6jl5HfkT+l1Rg6/lxWTzxCDzVZy1nW+BAkIHUdx5GHNUZlbuphT6IjZMCqidasJIgGzxoyF/yYmaJtfPIU3su8v7UUPCbHTIHt438s/fF+qi2x6hWZ+W/xmgbXBTJPDJl3P9PuBromynVFhZSKGZ/f+b5M9u98cc2tCd4cAEyXMo+HSchgkFfoRo84vPvkBlp70O7L6DgIjmpQzUw6bA9V5nmj8FEwjO3mNOnZlrsyDkHYkl6gdiox5PlhO2vaZ+mYWzwGphyY0Fu/kJs/3bd4B505qWu68Q9+f5vNP4WKIgWpcZ5xlqhA+hrFGwdJcAiMBicf1EemLbh39MvBU48V5Qmw2VR0QoAjxTjN8Do7p8hQeOCrpnBCO96AJuUOG6+pO7fkBFmzNikAnK1v1cjB3FHomf0TXTiRwEn9plE94j64vTHOicwNaRAJj3JzvUGDrosqJ0CAFCWkmwsI2jWK5YQaJgjwuHPV6qM2z6KTHxZDrOF3/eZwJA+JybyhJvyD2iKCwkAltEsSZnptxsRkkzKHvWJo639CbZPb/LTHCnt43xJicWM47tdfBBEgh0AQmOMpnmv3YzCKz/dze5EOkEOE4aQXTsFCJeRsFtzNdoMQjeoph0mCOyE9wzyzi/6yODObERIOI2ufg55x0ZBbq+O1G1i7lQNBpbhyatz9Hsg9Bk0eslj7C/HqrzvOpg0JSlkLyFWjG4WSiBCBFoo5qOnCTh37pCxD3JNaq36D/9UPNYda9zr+DPKIV57AC7X+i9okqWuxo7NGLe9I/b+NCuDPXCmEj/8wXSIQJmz8W7ae1F/gQPJuP9SM3a/s79bnvA3hiOuFDRGiXtpfBiF78RHlJE9WKyMZ1+oydTU3TwfE/+RXJFk4gy4wGwYklyNBGdPtjzclPTFB+LoWZhKgcz8bjybcX6tz668DbwMwZVV0MaOkJU4+DK3gtib+kIf+gxkThwT8HmHhsktWRvc+BIIFxSUhyfW3TC2AN2NyaXKNjyEz1PLIkui+tIzzOakk6ItJulYptmZOUw/DoN5mNkeuhTOgXGjKLNM/tjosWRuyj2W8IxVt0HYT6v9iMtknZbx0FXM404GswPtzzhaOvVxMAkLmV7vtOhcN0qTTAdmA/nIq50E/+TA/E1UMbhI04TXGhVOB4O3t45E4ZajVlYKc96ZTLU46gm9kQeZgXT+wRjrPpRGBaSTRugNdZ+FFrJw20xgEwOUzlEHETtXNCzqbcMdofdUmU6t/QbHeYCGd3CxLmykTIGvwRPYnJ6NtpFXNhjuF8c4zwQ7RvmjZIYEQXl/fpPcuDH9Vr3IAm9RqKERrID9TpXCAGOUH/Wdwz1bkugi/J5ofYWVGYolueCxEpicO2toqVh6ynv8uEmgMtagd8IHq18AjtQKTtJT5mOl5oib6Gg5aS8IHeetFS0+ar/P1OBZIIM8WFdVLvucMYlbjpUQDXDEQQQhJHjmQpAz/FDn12k8PsCMZylS0+jX2FH2r7PZqtBmHp0nmXCawNmIiFTH72uaRoW9rCbHG9s0MMFDcfk+8K/ReCPlOvkvR+oI7+Y1PobSLUd+r79Rqnx5D2iUz+B/R5Wtt09Xmzxox+I+In06mzxRoADZMc7ASbi2LO9uMPQBA6VcFoN/3ekubjQHO5MLGwABB0Rw90Udm4Bt9P59TY/QmhHVLB4QO+XjQjpfvs0/VRjUBb+pDJRNCCIA8mvM3L3LKgs0nfv+qb8vq92tB8uwLgpjDx+QTiJPIE1zi591rNJ0SkaQmhUbKuLvlYO5SU6naQ3EgRfIKXapKknTSRNu/G2J025+qPWgtB1DnRcC2Enl0vxf5E8G3gOLtmSoTcZhIQoe9THIpGMLANkTGXtMh3oKuICVbmB6o/TCSeULtBr7trPMH+Bf+3VpOwoZt8O5QO2CYI8gxrqBwQ65xLc07VMc4cKRDGAQER84qZ2/F5JLDfMCm3DB2T7QbMJw3fazRQFlna/gHTflX3OfNDWr5G3npqWgKorel2ClylqpuAOsYehwiAG0H3QqwyoZqqSgjQkr6JlQchs4qMcuVZDYrgrtLvPLuP71iu+RmbKW04KiRzK+0naqdoMo1vc/eQek9wMknSJloKzQ8tzLJJVr9cTHKRCGV0ex2bP5y3rrmdgOIasfnRRG2JDQFRWt9eJcmCMfIqbUREhucQDi8eg/G8pkbOd8oL5eD6eX66l/aKCdvaZSE4/F6fLAYYXrYcWlLm3ojmdRwjzNecmHfW2DKRopMIprwEngjfTofDvJrE5IzHiURZCctI7VzzvV7TRLtzYq/u5z5tv68m+mH+D8TDYJLTzbSPIafUC2JELEh8h2Tte/AsjrCR+4VvrLDj800jiQZEtjbZ1j8eCHsmoAHD1OLpsvsO+FAJXYcqeSTCO3QNj26+DTjwYDPt4CHCpB4qXxbKvsn/pNKXBEf3XPa+75D0i8gTy5hf3wud5rhW/8XnIBqENttaTVsbWAPjJC5BFu7tuK4qmIQLJQv7QxqKiBz+hYUiEcQ36HsYjJ7DH9dx7tJvpAtG5D+yMS2LIA9tM79uXs1v1jInNL/sJECoTHyq2O0NXagdJKJHzaKiJN2Be+022xLXb0dcHNM38a+VpGI9Oc6n9mMzi9WDZJdZJHVP7ya4nY7MNhCqn/PYMPYGY8JQSYyaRgOMMpO4BuqVkMB2iGXzjkKEurH/yYIPOshRxiHpX7/Y15VgB1yEm/wyJD3b5Exo7Yijr+9zLRR+DpXNV5uBU5g6RwiuA3SMs8R4r9Y1DpYBbQ84vrWuiNZr4JlLCZhUlQ285iMTmsNDPogLVo+2T4XGbjOkAymyOrj/dHqMZdqsH6FJA4lYqi/oWgmNvWWAWXkoT+qGw8DE417uVFDS4VCqiDSeZnqLCTVVznLRfuwxJ4hzLYIATv6kiXK8HccV5+2Fek/Th3folcU+sh2rr2iy6ahOjD9NbmsQoagu6kVXkD6+ObLlxwGJ7okXIy4kWSE+zAgzCRl2+QKj4Oy+bnaU8a8dYDjeo0nCJ5FfofOEcbz2fHL/0AR2ojs25XxMyvplOuFPJebg2iLbTyhVTrxMslECgP3TVtQl7dKU+CDLCScW3RQCwqNIlPC5/IHsOPa7Okfpty/o/hAwofwE2mBZM+todjUTjwLXhEbM/dnI9vPY6x/rnkXjwF7iVSPNkb+j1Ihk6QCd3GNtv9MAcdGnKgj0Pb7JEAIRpFQbxI3uJf80sAct/bQt6rB/8gyc6uGyb/swcixjrchop96JsUYLYZ4Fky1f/b+J2YRGifjpPR9rFJDUOMzuf0Upt7QLhIDjONORGeY4PzVOLCpCCHzPryFoiP1TCv8e7YPFUqy0/C3fdCQiyT+0M5n4URoPWPtKu8xNnajteMzB1LLNQwJazuHsgftwx4B5AyB0BzNYjiDhh8nDfRrF1Dnsc1ETl12j2wdhYjlce76ZNIHrs09UHea5G15TxLhmpKbdYXAHQEJuOrilpi4qByfthUIDz+u7z5MEYJKwOReOZBHSZTJCap2mzzj9HDd6bBFORSrnwPZfClFww2CsHFxPfhOsbXT88EeOFTHsNvSfBJsgXhwlRpFQcPGhE5kxX4sdSEubD9W79PkaXdeJJrhxgBHpmsJqQZKV8USpKLrkGgnBt4lk3DVsDQgtNMG0k4bSaNJ4bT9rW4GpjPZkHgH7HXT6KT7lsdLn6rjna7C2nkdQjFuzQwpgMN+1w2Hfoyft4Wyk3kst6S25nFn+or7jIfpZnJqsOEsuZVtC2FFXM7pQLhyr/rMNUaOxtkDSCI3SeepYNb0UcAMc9pWJAAF5TYkkZLtKNvwGmjZfODGva8Wxz0PXbSBpLSScQERQ0KeK6uatOZvcaHwjGiqQqZ8ayC+NAgxN1/Y5lh0gfWWatZmB0g40K4EL9/zS9u2gwFIwSrBsL7jHjspJGySYQbxIa/R8LTgc4n3LstDJkhBh0n78mRGfkeyJce7RTThAJ8kDO7PtLPnJCP+R/iNHuSlobA+2GRemXW64wUPFY9+u1/mwNvvGkcSP2rdP0tmgbc8WQe7fq6uyeSdCZXUiZSpz+7zAvoDXu8vXIUzryIr7W+G40yRiVp9xeCnXeLO+I+hxoP77dO3rCb5+13fpfz5HSWq+S9qNY+LkYu+H1jhav+83EBBIiB4BdJHBT/q0Pl+35MjWjoYrMyRs6TqTwwWozuQP08n4wUK5qzXvg0GgnQLXwTjEyKIcJF07YsHDEyM0yY0dXX05ZjhadZObtO0sRHa8vxIN5h0XwmRbR7dMlBfb7HJpP4WO0jBzcrhR/W6GTYSM5x6ygq8+1P9L+2VukJiMJIkhbC9AcvJQppz8EJe8yJxx4lJmFn4QD89hu4iyvc7f8zvfjTIvMVfwo1LEMYRZrMdfTeD8nRpgHY/MuJQU5pqi0R8BgRa9tIavzaHhdWN9tZ0Cbqrj9C71SCvSyLzSkLkf44cQ4rmEdGj/pgZ+RzhcEQenbooLl9NP8RvlAy2fZkfCal0+1SCTI30+buk/yoyAkIkiYWoF0V4Qoz5BRKsbQ82QNY2Yw4x0ShB455zm875DyUdHuLQ/P+Cms9H7oAs7n/neiUeYDjMqMY9zBjyz/eUmqFFAKoefkFfGakhS7ywNvVi40YedbCqWv+K5SuA+WQPTcROfw5n5purY2oWHDNEW9XibtsvlE20TOLgjNr5BXzXRRxPm44cyxAmYLHTKwKYm0TTt3MLhYoha0jUWDOV5gJ0Fr6PoXK9zopSF+DxhyUv0+TCfFzdmHCDqYAZqfqibmg2mmHqspXbY6b/qaBSxfLSIy+lF8LRJnXdZCZlyWhQRADhF+zhDjLC/fSHPSf0bZlJL0alHexvvQ9oqQrl7Lmgq8f8wz4gE0dbzFzr+Z3295FnajLqSsP+XljHLksDcbIP5dBS12kOv+3hYAKNxFvAJdyqiepWnJVH7giT6/bFrHFY7cFrDt6CoD+K73SbkYmGTSIICYnW3EN4j7esXWpJdKy2bmIxjuTbKGXbGUdr+lWacWXcNlPMvpswFBQ4m0Su6Mkb5C0tmT9Z72raKoZZgRjjfUn1ORBXPXYc5lxLx29GIe0AV9Pt1nutG1p49KIAmYGE+0jcPhz7YASG6tKMJjy4G4Xu8RgR7mv5HQzaZRnLiHRb2+gsxAgWU0grhfFNOf5x+EyPV9CHGz7jS23kdirQKI6pfK40Tw8SCAWVOOZI2FWtZYBCk6WKBOeyK3pU0P7YC1o4QgVvN5/iQBaYMTvhibw7bR4PstXacyf5iFkUrfx7uT5wen+KtJn6ewR5a4xKNxEgn6HV983q6tsHHQEM0RYadi+K/kv5oH0LkUcIiE5XjTo5fYNUGJshqMqkKHgIgpEtfX9rp5OFVtBAmTArRhsN+jF8d4ZqaEsE/R5ri8c0+xDDSNC4wFHMRvYrHJUx5iWyuqR1FtMO/YShfU1CwquBasc4RImZJ+KZWCx+CCFF38jHyHZ4bjECIt37KBCXtVDrj4CeixzfByUQb8LuX1sq8IhuOueXKAzGbQ8PSbjCScx5iqnEVywUFqwKYLfgUjrvLOSeHweKnqN2iEBNtsDFMrqZGC40Tzys/zc53hICP0HaEijG9WPKLnyJH3DkO6rv4/RiZcvI/9N7fTT272OoFqx9oCncspCARgq7PFjG/WgQe6zHCtHqRBh0H8UnIxL9Kr3R+J7x7vl7lzNfnNjmPY0JDyBzz/nD+nWuBafBfxGD4PKssE16wShD5AJ5qdJrscR44Q8Ro7540dXJSpk00r6YVzimS4Mu3JiJHVLd2RLwbGrNns15xsqPBAH5JymNQxo0JZcKvN+mVpGE8DiEezXySNQrmFPF+wsMO81a7ytQ6XtsR4mW9+1E6xtk77JoSnJwjCKF5ZJ6jopgFXM/3HHNNLB0e+N334hnNHgpWBF5IVd0/EWtRUu3X3b1FWTAKUpzCP29T/UBEtfxtXyBesuLukEhOosltmOCb95sbZ5wydJtbFU21YRAejkPXk/1tmrnpW7MuHWbYLIbnf/Effj/fmmSufpnGmfpemkYain5XEOuOAOFWymWoLBiYazplao6JiKX+VOl3b9NZ3+yhYEUQJS5oh8ESckrLCdMCF/rJhInanA2975cLEEcK8XpNuEyn7oG/Hsd1RAqilpawX3KBiB3ij7oqR7Hqp9l/sbabeljTmocQMA/UIUeCL0KmHDMtfBCcdsK8RLWcN+m8Vq8y36Z2WzDjv62IgABPz231nxKDoBVDED1N408Hfy8MsvJAckdZSHZjxDCYXsnUgrBc7zW5cL/fxYBoUbSZ2WCihyFI1kXLnn2tTRIwu7bgl0gD4CuQs0jFikS92qXoCZhVJCsdvaIgkb7H0kCOZO03GM51+Yp9m/BnnFSkIR/rNHSc5Sq7iELB1orOhkGAw9kDzcc1CoOsPFzxOcQglNN/U7bwM72Nq2rFIBD09gDi91r65niYbm4KIVOIkvacOdqAWRj4Ios1hdgOJiKr3O5KmMNLTh0dk/3vtdmhUaNjiwTFMmiVMLPSA4+akTGIS1bcLC/7vTDIyqPHINWX7I/kN4i+vWS0kwbZHgbBpOEhL6Ma3bFicJykJqu+lJKVcSBXAoONQ3SPGX5MXMzJCdutSQqDPEjhhgesvuOhmDi4LrVPN4ky+tP1/YV+v60MQiVsmFE8pCUeBpQP1pin1X5t7YB/wtheeM1Haz/5sQgxpy7padhRJjBR32wfZnvq5QqDPEhhDYJJUV1pe7z9mAMqjWc6NEl4YJsYBAKgRJ18xhw1VF6v0m5xdFuvvJ8gAEWEhDjj4UFyXPXf7QUFj+yrt18dIw84eBly83wUX7eYY6bm+Yuf0LmTeHylzMCnLtq8a6MwyIMUiUHcqE5OOZWq7fXtlqTbwSBeq7H3k0Vox2lMi9hu1fGSqcWir/U9QsHBjpzLvXEe7sBxtSU8EnwpBMq2/CcaX2zxvvzIAxqhddb5WAkQsLurN9fLU71YrjzXudwNHFi6iyZMgYulojDIgxQDDCJn1EwiAu096akZfN4eH4RwLuvJo+T8SmklWvZIYstpT0tCE/g8SCw8Fu4LOsdXOUm4WLCtI1Nu/5OZjvI12scEJCRtanZ49slHNS7xNQdzbF/DglEMkj/vxQxSolirD20GASweyntxMbaXQcCbkdIiNkK7c5SFjLHrkfhultY7/u0+Nl1EliLB2Zb/mMgdnUr7u0Pf/06z1SBi5eDrpDmo8j3Y57Ici6FCQ7UYpL6ixyCEv4fyJIVBVh6RpKO9/sbezQIsNIo+VHGzloNBgMsqmurcUWsqkonlZtvVpTqufCCe7ruNpg3A1MJ8in3RMf1GfR40sXKYSeQ3bVzzyGVLHBKNi0cW9BnAIe4mOEEHEjfBy3+vz/RvBSsECMSPJrA5dY0d5WTjQ5CsdkyNxJaLQQCaJF/zkcMJtalHW6JCnDydieZxeQvNpcL78bMwjnM+xNJax1hIMyDxl0Nz5PAa+szUcwmPe569WczwGb02z+BoBou8ysKsFUS3w+MW0gMg6UC4WYTTzzk4PNs8T9BNCjrRF3hnwmXwU4/dLkmOZmQfy5UV31a4QfeIh6FGEIRnVPJA0YxBCBQ0TyEuWAGEWp/Rzdiim3S13q/Td4POqKNa9axHqS7dfkST7Qs1r5/SK34WfYTXSVg9qtHmtJLdHIMO//UBzT8LdjowozCz0hglpTG5yED79+3wAwr6YJ7Rzm7KfdDDe2Ytmi6/HzH6fmFBQUFBQUFBQUFBQUFBQUFBQUFBQUFBQUFBQUFBQUFBQUFBQUFBQUFBQUFBQUFBQUFBQUFBQUFBQUFBQUFBQUFBQUFBQUFBQUFBQcF2YmLi7wAJSteLNWbtPwAAAABJRU5ErkJggg=="  alt=""> -->
            </td>
            <td>
                <h2>JWS DIGITAL v1.7</h2>
                <h2>Solusi Intek</h2>
                <h2>Indonesia</h2>
            </td>
            <td>
                <!-- <img width='100' height='80' src="data:image/png;base64,iVBORw0KGgoAAAANSUhEUgAAAMgAAACHCAYAAABTVhYnAAAABGdBTUEAALGPC/xhBQAAACBjSFJNAAB6JgAAgIQAAPoAAACA6AAAdTAAAOpgAAA6mAAAF3CculE8AAAACXBIWXMAAA7DAAAOwwHHb6hkAAAAB3RJTUUH5QQMATEqKS+dugAANXlJREFUeF7tnQm4ZVV1518PSQ9p2+50utNtd9KDdhtth44oqIg4ocU75z5mRIgBASlQGVRASgUKCkQEGQSh6t03VDGoiFFR2igaDaJGJYgiihgcoRVt2zbGGOKQ5P/7r7Pv3ffce1+9V/Wq3iPs//ft707nnmGfNa+115koKCgoKCgoKCgoKCgoKCgoKCgoKCgoKCgoKCgoKCgoKCgoKCgoKCgoKCgoKHiI4eo1/3JifvJ/TZx55j9svikoKOhhtn7GxEy9eaL7/F9vvikoKOihW58xMV3dr7FH801BQYGxqf6NiW71x2KSv52Yqc5qvi0oeAhi0zG/MnHpmn/iMb/nP/XrdKcWc/wwGKT+5MTM5H/2b+l3xjsP+kfNHgoK/h6jW+0iLXGpxtvEDNfr83vFGHdMTNd/YwbpVj/V+4/p/bv1/jq9XqNx2sRV+/27Zg8FBX+PcflB/0KMcayI/1vBEFsbMr1mJp9ZNEjBQwd/O/EPRPTPFqN8XAzwy5GMMV3/RL9vmpjf5780/yooeIhhvv6dYJI2c1S/EOO8ydqmoOAhi03Pe7iY4aYhBgmtclqzVUHBQxSb6qeIQf5Pwxg/0vuv6PXn/jxTvd/Z9YKCBxU21f984sw9/3HzKYBPsS2YqV9mhpiuvzgxW/3+xMzUo/X5jWKUH2h8e6LbeUKz5fbjqr1+bei8CwqWHTNTzxQxH2f/gPwEJSJb9v4fza+Lx3UH/jMxw7Q0xbUTc3s/vvl2YuKdB/2q9r+fo1cwzbaA/Mlc5znOp4CZvZ+s83ylzv1h/lxQsMPQrXYVUf+ZRtcEDiHjbC8VmE+zU8+bmN/nXzXfDGJaTDe3z9O3qXiR/+DDdKtbdJ5n6fVzjogVDVKwwzFXP0kE9w0RYDjUq5XwYOTp+rv986wusnYqKNghwJyaqaYiLJvnLqoPyVd4VLPV1kHCD/OMzDg+x2b5GZhps1O7SRM9d2KzCHu+s7t/w3RDw+D3LMXPgWG79dEaP8rO8//qPC8oeZWCHYNrq38tQn6JGOQyjT91achMdb/e3z0x09k4sXG//9BsOQz8jenOf238l/3sD8yJgGc7G/T+5drHmXr/ar0/TeN1en+Sxul6f4J+e5WO89KJuWpSBL67y+Fh1nFwErLeV0zxab3eo9cH5PD/f71/Z2Nu7brNQYWCgkVhtnOwzZfZzlEi+P8mX+HxE1eIgXJ8TFJ8fvLfWyt0O6/wtjP1xXa8Z+oLzRjBEMEsM1MnatsX67eTxXBHaPv1zX8u1ND3nUu1n8P1etbE/NRB0jS7TMyu+bfN0fpAQ6HRZqce6zFTf1CMcdPEln3/TbNFQcEOhgmvutxl6m1g52PGzFYHTsx11onIj9O4IDSGGALinq+e5dWDaB1MLZtce/2aB+YUWgKCxsyC+UIjHBoMJU0DE8FAZqipaiSjJMxMHSKtsa6sVCzYeUgmU26qQIBojLn6hSLeMJEg5PnO8Xo9QAT/GPsT21p0iFnF/vFVMLls7nUu0nGkxWSKzXfWmMHa2HTQw8Vkv9V8KihYAcAwhGxtKoloeZ2T7zBX7WFtsDWmgLkwyRhsuzUfIZlRXTEFPop9GZluMCZOf0HBqgFm0pzMn5n67MbXOFUS/RmW3KOACYZEZ2ktRN2VU96t3qz/b9LrjF6v0HdvNOFPY6bVT7IpN8pEglGm1/wnO/BznfP0v7X2Zbqd/fVakoIFKwyIl7Uds/W5Ygx8jYNtBrUBIc9V/12/HyUi3iIT6QsOu05Xf63PTRi2NbyAqvqp3t+n11uCiSarkQunWKWIRpmDQcQoZrzqcDny/7HZ4qEJNDHzjkk6M/Xk5tuCbQKTSUQKJ3lrMMHXTxExnqNxhJjk9SHpRag5+Bw+w0UanxWx3yrC/+aCjDFyVH+h16/q9Rs61se1rxNH5jPIzs9VLxDDvkEMs07bHTaxpf7t5tetg23HZfYfTLBm7fxPzdkZGndo3n5pAVMCFdsBIkHd6q2OUC0EE71MKAjQJpUcZBz2NrqTjzFjdOsvatygcaiY77d1jF30/t0OExN+7VZ/ooE2+YG+F/PUP9H4msbH9Pv79BsrD2e9v65MqVim+z39fqu+XzsUvuX8YN45m3uYbi9bVHIQAdGtTtVxfq/55sEHzFcvaa7P19zcrRECZrr+f3p9SbNVwaIBcXlCXUW7VhP5XRHI/s2vo9GtnmVTCeKb7bxoyKRymFbmDdqiW31E2xzsdR+AXElX5th0/Rl/j8TfvO8jxQjvsCaKvMXV+t8G/4eiw2AKFlWdZunuGi79l2SlTbDqPXr/tKGIGuFhBw0ICZN8lHZcCOzXDFl/1CHo2eqJZsoHQ/2WgyT0Fasu19x+U9eQGOP7+u5tnkO2KVgiIG6cYmeckeLOjkui15fouxcPmRsk52bqU0TMZ2m7w5xdzzEz9Qj9fpn28zXt7/SJKzJ/wXmNaqOP05XWSbmLyHNc7/9C2C6Brz6g1+dq7Ov9xDqRn2lMu0IXf4cMfiKErs5/pjpyKMMe+z5F2/+e/9NmZphqZup3fQwYM7TYz7Svb2l8Vkyy37KbJZw/RZiLMWW3BvJH3c5eOv95nfd3svm4T+fflWZ/zsjQd8ESgPnRrT/Ym1yWu87IvJnt1AMEh8NLcg7tgFk1zBxoobdrfF437VPax8mWxBCCb2R1gcbnNDbo5l2u8Qm9l5nmCBbaYH0QKeaVfBSbBdVfxvnIFJup7tTnb+tVDmd1nt7jwCMl/0rvv6Ht9Ft9ps5jMHoVtV7najRJSmmlHDb7rNX6hY3T1Y99nOXSHtZoOMsIF1/rNyzxtxUIrunOPtrXO3WuMHXDGNXXdd6X6vunLViOU7AEMJFu+dmb5LuG/BAIfJ7kHJEqmSvt6FCYRv9b40JLyLCDT9HrvLTNnF5nTPDhU/yJiT6Ox+pBNENz7BEjtr25OUdCwh/RfrRPmXCur5Jptom17Tq/8HfeaHMph0v0qeni/KYqO7E5+OzOjk3roWDOZzW/bjtgsJnqcdrXeu1T55aKPKmG1hwtFUTw8OW69Y3a358350q07y5d2xtCILUCJVwb2rt9zQWLBJOKxgiHmvUdX/JNTeAmUxoCcTkrLpMkh4sQxRz0r0oOs00XTCRJs1wyb40ZRo+fa18/1H6+r3O7U+/FFPUf6DyeOWRXY25gGlGUmP9mxx2JK2bCeW8v8PL5Sis5/CwmpH4LrdImtsXCuZ76KTpfaU2ib821UDSJz9StO0vaNwIpqpM/qv//ZbM/hMvtOufXhq80xhRkMRravPgg2wjXO9VPsoTBPOlWr9DYtfk1bGabLg7nHtB8GyBLTl6DKFVavYe2wR8IprlXIyf2pQ3MJ/wBfBKcdBjZjvfUIUPnktCdXKNtP6/fjx0gGkzCKIFZLyY5fMA2x+yieHJu8un+jO9EFcBS7XeIkASok51536/qe7qOa/U6OaTdxgGmtfCpTtTAL3yg2d8D/sz3BB7y4MQocM3TuraCZQKSLTmQvBIxiijQSQNOe5gPkl6YP1PP1qjCXIORJOkdCrZp0XRM3IYR7X8kMWVW4WB7sVa91pn4mc5r7D+MQkhb+UItMwlTEP8pfJI9e8SFcICxtxUIlunqBTrmFr3e73OPca+YhQqBZ/XmdGvgXNwOyXN7e8wB+/I8/JHeH73oBCj3yw58Z/fmm1WObuc3NVH9Clirdkvol5nIVhvQLlGJu1bEtVvzbQATijUXECwOcLdzlYkYf6NbvctEHG1D+wS/rQNNktanJ+fT5SX1C/2+DSQ5OR00Tx65gqnN8GT0pUXGlcMsFoStibQRhYtcQzrfr+n14onZyd0W7SwjmKZl7mLa4VP0BQuLvsgjvXAo57M1uNKheu/ExheMX6uz08FN4MRyaQsjYHcSz2f9QwLrrqOruezJal3z7eqAzQ5Xyr5ExPSKAZvZ+ZP63Zr8s2y6UN7RFVFExvzruk4c9rN1k+U3NESzvYOwZb5kFkHDXI4quQcRNfqM5vXUATPEpfhyyPGpaOywNRNlFLwasjrM15k7yzP1lzUX5ziHQuHlYsA8E3XCXyMK1btmwuHVdfr+SO3vefpO9ONjvtgRLDq+tCNybUx3XqT/ydycfLa3b6/ZWRG45qi+ZGCNgkOp1W2+8NnOm3o3BdVrCVH9UhM8bCfCbNQYjSOCHQkTWOesIKbMaQeEegmF2v9wxOpVep9s5B00NH/MIyUUSH78C0w/Mt9tIud3fBQcdkeP5MQmsO0cxDZ15MScxlL8DAoju9Ux2vfH9Jo5yw5fr7NptJS8CSYi/kq/NxjjOzrvOdEJxK3rk2Pu3308ghwaNrfwzS5Y8IFD0JRD5t7/3TrWc5tfVhCRRT5jYKJYy00JBRNAOXj6DTs42v7/TN8f4e8AkpKmag5LOoT3suaX5UVOWG0ic3LNq/+O1bn07eeQnjfp+0/qWr+k6yJzy9LWdIOXf7h2q7qlOZ/ne17Cv+HYt/Zscl5Dym7W7/PePsLCZw3cD4ROMD9h44XDrcwLznBX2gqTsl9HJmfZj2o43s70tmCmc3yzLw0nJy/Xue0ec2zGWbhmzTmgBUpIMCdjG7a/d6vXusNhdUkSrBVhCU5Osf+32BEDdC0PBnnASSzboSkKUt/X/OcOq1iAPRthWZobbHulqrPavrFPNeG4GYMYFI0F8JWckOtcOjGvbXJEmcftksC/q21wJAdv2o4ZhDTP9flyntZeMkHcfqj+A/12aHMub9fny3RtVc+/YPtu9akBIg6zplneq3lvCwfAPYr8zut1/z7fv3+W3pTQHKX/PqLZetswUx2ifZI4JIm6S8+MpY/XoLO/wJCvle4b18y9S4j7eJ7m4Fq9HrZof2iHwSpT0pUbmYOkWXK6YKDEIEiLyIQijS7Wb3PaDrtdGkUTh+mC2mbibPdXb9L4lrb5c/3vJh2v348KKU9J89bCiPwOk4a6ng0p6zKFu3umiNd7kw8gItWEbwGE1a2u8k2J7Pi8r4vchNdwVHf2rnO5h7P7kuTTOj5+Duc+U/+h3n9C470aJ5pp20RgrYJJ1JK0RNli+e6xA+Ywcx3O7Xk61ley6/mRvnu/xiGa6+UxeQkmcH6JwBMIVYcJq+M6uSgh6gLNpA3yeYm2S0TSbHEQMJApmACt5b7bigJnK0oeLtMNeLlrbuL7PoOY43MTq1cqgJSUHc/aBwoH5cBvmny63l8cnxt7cnByzu5JP8J/dpCrg/yZGw1xtx05fo/ycf6P2o0eV74hujHsz+u8bf+u7TEzgIFchNhZo//tqvf3+pxwBkGEJymOy9oCLdNwToQEHgKCLiXOKxxuST4/dYiPPw7kcfCX8rlw9LDzWjnqcqqbyoEoEZfwaObEw5rqHRpTA4GXHYnZem8dV/fIguAM0wlahRq29CSu/vmtNz0Rho+HD0Fnb1mdNVg43c6W6sRRyUgof4/92iszuNJhtygZ+LC380XBGHI4Xd3KszMoNqu/698xL2aqc+L/+ZA0RTogicLUgOivtzbhpjvzKmLOwXEhNhOciwe/1OwrQqLsLwr8ThKjDIaeOT/3wRKjmEB9Hjjnr9MxaUR9oL6/XK/jbGeZZvYPpGmSybKUoTl0kaI0adJsjkqJSTbtMj4zjaa2FpHvkQCz0PSBKF1azx61ZOl4jbM89bwFcyQIlNy/WQ5EoeYHzRi5+RcmWb/XF7Tm/EvnCfrc9wP9fWef5l+rCJH5ZGEQJ0pFaySqUpNmnzz2bH2zfqPYDo1BBOuvdJOP88UigYmpm8jImMpXILOLdDMTOJoRE0H9DbC5U98Y+8d2xXSTmdd1acOVPdsWhANIb6tTmnDtWm+TIlVcg9vrIHWz6E/4KpSjvFvjLT7ndB7hE4QJMED4XJttaSIvCIg32k52wq+6Tb99W99lzd0WGAgRCBYfLCcaQpfM3UKmpX0umWE8CzGBfcyxNBfTdurIqAqgDARnWfPDHLa1bxuOljVNKZYT+DZ5O1cEHibiQBhYA1pxMjCrI+v/9trm36sIVnWTu+lGHOXXvimFagwG8XDJN0tPT9SFfVefIR5qdn7UEN5H9duRnqgckRk9Xb/TDO0HPefdvkEm/dAMSKEourtrYvOaR3q7BLZPRAbz5AxkM8m27LEikr7D52yxy0fQGIusqfJ1yVdwcSFd3MX4YvJptKMcbGtRR/2+E+dKlMhPlmIb6qLYD/N2gwhR2k4M62uVj5Tsaj5TfrJQ4zrMxLimk5tvAgQg0CCUnlwrRmP/5DDy+RgH1quwLCAE2S0LHn97EPfjCs1L5Fv6c/vHthLCF5RWz35DYK1KDdIGE475EesZ0gUQGny2HU4zSM8kwym7Ud+NdwIt3cUIIS229OxMCCB8lTRB94ugZJKJEYPhRmec22A/lLlbg0ydOGDH4ky6fKN3HYsdd+t6K72iefrfwxD4bMBLQ91g+mS9XhmazeYc2pJixVN65+IQrRzTlCH3tet8ydsshG51nPZ18UACj33NSqvRFWUpBI7gwx9IWpR7h9+2nIigzDE6RmvObXm8vec3ISCikXi2jQQslsKqBSUaXrNgrYDkZBlpqEAkqAsCySNYGjPBrHk4Z6yZABGw+MWmmfdxqyVdDogoJHaaJKRyYwZlocBxgCnJF5B3gVGRynn0wyYeyane/pcwKHcn8QXDpjUhnTnNUzQSCMb/sIj1Rr2PCCDayz6U/u81Is33SHqSaJt1Pgl8bs9HG/FIhXkTVELkTQhnHzFgTm4NmGMRGUvX9z37C1sD9xFGxxLgNTcVE9DUnKuLPZs1L3EMVk/eoms9aigjHiX1FDRiPUgzV5PNL6sQ5mg5ouF4ozmQjuv12jCDifZneqUM/Aa9Etb9uS98FKK+aZ22obsHTuoHRbxPaX7tAwLsMURrkLcYV9gHQgMRtcpMJxKU1WG9MmmkfZiGg/tezAgf5QLtj964kayal92OL5LgKl37XP2wMlEmm1g+boRpOVcWQVGHlZgeX6JdKwYgQEwQM4J8uRQIcfia+rfJ1+iVhOdtGq/WHNZm2ghWjF8/QSjZtV6+Ps7vTb15agNGIAIVKyWv1PayEsxc8hmZE5nCOdO6TL63dgQfFYGFOX7IgjVVEYi4THO9R4/xYOTFmIs7FUjdKBk/VRf1OEs2S9DGeY11wiQTRXBS8ekZ4YSFc4Rj1tF/P6JXbgKlBaePNQVIOobPgdNP04PMZpX0gdgxn9AEbZBPiRvRJ2pGhFMvNXNhFiZzMH673yPffqHh3E39Zb0Pcw8Cz9eWRH6mM9CFxD2uMF8IDmiumFuvvSbIQO6j+f/MFF3nw1wLCfxEfX6x/vtm7ZPgBXMcgiiECK9/49E7P92f0PT4hARaLnaYfZzmhdG9Hl5MNsokRks4qkeTiV7Sd9S8QA/n9bQCzBfry4/U/j+k/588wEALIT9XJ6F1fovRbDsdXFCsYqMk4usDNwJpkKQNdqLzCvo+OZDWQFNk2FlnQYII6TltKbQQMOtiuSpLZrHlYdK/8LFDW8lHaTLAbYQvxA2EcCDkjHB4z7PKbTJyPlESsWmfp1vitiMrCw0c82QKtRkEYHcn2xoQag5JerNzSkTPQuITZWPNxS6eL5egYCrpOmAIomPjQ81LGffq+l9uxmwDPwSmToGYBDSPiwNFnOFXjtrv4AhHf92A1oq1Np/0tfjaxPiLhQVvMrlkzYzTbisGbhgFYkF0n9cFvl+vyd/Y2OP0sPvjQqKbIHVGMs+QzCyy0XskAIQTDQgO0HYv0f5lo0o75RdOKDhNCnkXEo1Rq/SAbtjx/k/c8FOafwRcnuAFSdiv77NZ41B1bv96kO2/1/tJNxJVju80KABGD8+FNGAiqLaJlZDb5VEEifbEFGne158W49Bkga7xT9BYr3O4S/vnuYajpfT2DAc8dKzFAIaxcMIcHrGvhUY8p7HfeSXCtx+O3yXo4vENB/m+bo1ZQkCGP2pNL/911QACoH6HUmtuqjO2MgFS9no6eyJTOHvxnHDfCLSFs+FRtObQKs/aIzeCVGzMA4gX4ieak8oKwiSLSBHS3u09iYBUND54gWzvKF+YlkmQwwk+JyQl7WTLQ7g4vRTzoXEGiZ+OHzeZSVJAAYmPj9PfZty4fSDcPO+OJQsXz7Eoyv/1oh+y99jwRJ2u0XnIyZfJNs7vGjXiWgily9Sjc0p1rfZxvQbE9wnNwZ+1rjcGQmCUQ53DfcWchW8LlhgwL+YU4Wubhw4744gnQpY520rMhtbO9uOoHg30EGgkj2Vair5y0wpt52TswP8+MFB+suJA4ue+AiHAUQxi6Z2khOuhzrCmQELj3KF2wzzKLrY1YEaY0qqdBJe/0wR1flP/pSz7p9JCe9sxhZgoSciBCcFNgqFxTmHmWe/nUDEnic+N2iYqkfuD5N67RagH+zpZVzEYyh4x6Ls79QgzFo4j/bfIFS0EHGdn+umSKJOKNeNe49Eut1hwkKSUGYjgqf9Q+9rL14XzDlG7K2TnFdZm1kjVdRp5NBAG6Vdgj4Lnrcn15P/zQEDpPlhYyk9CcKWQNQwR+R+2/ZF+D03FvbRA8IK01v7ygQlthkOg7uX9mg74PLAd1zNtgbwqQdgt2aM5g1hDcNN8ER/pSWVMJ0Kho6QREs4Ea21Dvc6HrI5Bqq6FECL69S4d96/1Ga1wkt8TW0+IaMxVsW8y7rv8ilfqeZGUGARpBCERgYnEXvtcOA+ZdR3OVTb3OFPLDHi3zuFaDd0oJC3aDqaRlrD5RCfEKR6qQ1kO7YBoA8TCK4oRSRounim4Ts43ymGONuHb0RfD5YBRWBNC3VnSbvblUvmNBxr7OP82ChGOZqlt27zjf/QUPnxsTsK+SrouWgFJG9tsJey8SDOtP+esK9pg2oqQer/iwtv53r/J93PVIa/OzBnEIUCp27iAT/WiIfZh2plTTWSo5FM1AbXeEwXbS9s+z4QM8E+4UVQCe902JhifPeGneZKIjiSgdsMMQ8Ks9XeuZK3PN+Gi4QA3DWkfa6Lzc4oRTEt91xgGqe/RsQ90Vjj8BpmPYmZMCDeBc49fig8/p+9C0y59EDpnVePbfI3kNVL0B0EUlQYdf05gGxawcQ6pasDRpzzHoXPPH1OdI0zkmOP8XNx4jjL5BcwaC0GX7MScQQcWRn4OZN4EbqHxc23P2pw3aFztV67ZGq0x3QeGmIZ5X/Gy9zZwvhPB5wwSmkIq3Rdwh+P1QdiYEXFRnkBHkaZ6BDsO4eugdUQokoTY695PB1OFXArmRl+D9EO3P5QUjXAgCTgIxp3SW6UuqdAxndtiB2aiTSQekeAuhlTXQrAyL10mQdz/e2bg8Uy28IAxkMCJKXJEbuHDQ9n2eDwcFcEn9SRrmFn9yBxm66hcAtt7HUeeOxLBYhEQYk2BjFGI6CX1U40Q1D0jLE2haoSY0/4WMQjmVGeZdvJom2vsmsDQ4EBjHdpstQLA/2irMWzLGdvtgwwCJ0/Ti9Ynfo9uDivdkPb5hd3giVsM7AsQpiWi42LFU2MflpJiEiROFsWK5CDEdaedPYAEjXUSZ5uwciBxnantndsqGjIRx/kJvk6ZknnUj22jY8slmrd9+mavNGfSCBYe0tJt2EcgsZj5Zs6zyMQZZU5xLIRblNPTcQW/M7vHmMk2idtdYBBog/7Q6AGTymQVcycg3Gzijdh+WsdL/ZJ3KmwyOUw6uIabxmuurPXJ9cO81AW55Nwnfp8kII8KwNlrLqT+skyohUsocvD/uFGsepvUvug2iBSU+vV7JvLiZtvHatumzke+ClEwABHhg8AkJBZzIJ17Pks6R2zbRgPk3y/bwMml6rdlUw8N+XDJF8vhLDpOcmZaArYNLUkPr+f7O4h7wDRBOk9Wvm7MTEeIIDz9byBJ6nMjz7Sr7xfmKKavGbA6Sfu8TL9JU0ozxXw1/2uOQRAlWsDekf2Gg44veJpGv/ncggN/MIsMwoyDGl8aDt9MWm5FOp1QpoBN2q6ViexvE61A0jUMYkkkCRYn/307yP2oFuPcrYYXsa8TYdg8sHNHOPYwDdYP4CyyhmN/vceRu81OXHQy53wkoaRpcqCJkKSznWO8/xz5gqsY2MHn6Nz30PuLdUPaEa9FDp0H/40GBbf5JkZVr3wXt8PJ12qMGneMtPntj5A7yXIMILT1WTqGNKXMWkDisps1UAjzlsVTBBTeqn3hJ2n+hq4RwoNhyJhz/ggLLIYHYh8D2/YHxIuvElErqppTruzbNn8TCPWPqnQYNfBJ0vWEL5L7Uw/omo+3RbIifgiRGDRIG5RVO8fBSbYKB90HySevCWV9QiJcXQyNExZChII3aDKP92dMoLQazktQ5bfETWDdM4u5GvMoi46FfxBlGgnObXi13VlDdnvYz1FE2B8390zL6JLeSEln3ak0FXGTd6jl5HfkT+l1Rg6/lxWTzxCDzVZy1nW+BAkIHUdx5GHNUZlbuphT6IjZMCqidasJIgGzxoyF/yYmaJtfPIU3su8v7UUPCbHTIHt438s/fF+qi2x6hWZ+W/xmgbXBTJPDJl3P9PuBromynVFhZSKGZ/f+b5M9u98cc2tCd4cAEyXMo+HSchgkFfoRo84vPvkBlp70O7L6DgIjmpQzUw6bA9V5nmj8FEwjO3mNOnZlrsyDkHYkl6gdiox5PlhO2vaZ+mYWzwGphyY0Fu/kJs/3bd4B505qWu68Q9+f5vNP4WKIgWpcZ5xlqhA+hrFGwdJcAiMBicf1EemLbh39MvBU48V5Qmw2VR0QoAjxTjN8Do7p8hQeOCrpnBCO96AJuUOG6+pO7fkBFmzNikAnK1v1cjB3FHomf0TXTiRwEn9plE94j64vTHOicwNaRAJj3JzvUGDrosqJ0CAFCWkmwsI2jWK5YQaJgjwuHPV6qM2z6KTHxZDrOF3/eZwJA+JybyhJvyD2iKCwkAltEsSZnptxsRkkzKHvWJo639CbZPb/LTHCnt43xJicWM47tdfBBEgh0AQmOMpnmv3YzCKz/dze5EOkEOE4aQXTsFCJeRsFtzNdoMQjeoph0mCOyE9wzyzi/6yODObERIOI2ufg55x0ZBbq+O1G1i7lQNBpbhyatz9Hsg9Bk0eslj7C/HqrzvOpg0JSlkLyFWjG4WSiBCBFoo5qOnCTh37pCxD3JNaq36D/9UPNYda9zr+DPKIV57AC7X+i9okqWuxo7NGLe9I/b+NCuDPXCmEj/8wXSIQJmz8W7ae1F/gQPJuP9SM3a/s79bnvA3hiOuFDRGiXtpfBiF78RHlJE9WKyMZ1+oydTU3TwfE/+RXJFk4gy4wGwYklyNBGdPtjzclPTFB+LoWZhKgcz8bjybcX6tz668DbwMwZVV0MaOkJU4+DK3gtib+kIf+gxkThwT8HmHhsktWRvc+BIIFxSUhyfW3TC2AN2NyaXKNjyEz1PLIkui+tIzzOakk6ItJulYptmZOUw/DoN5mNkeuhTOgXGjKLNM/tjosWRuyj2W8IxVt0HYT6v9iMtknZbx0FXM404GswPtzzhaOvVxMAkLmV7vtOhcN0qTTAdmA/nIq50E/+TA/E1UMbhI04TXGhVOB4O3t45E4ZajVlYKc96ZTLU46gm9kQeZgXT+wRjrPpRGBaSTRugNdZ+FFrJw20xgEwOUzlEHETtXNCzqbcMdofdUmU6t/QbHeYCGd3CxLmykTIGvwRPYnJ6NtpFXNhjuF8c4zwQ7RvmjZIYEQXl/fpPcuDH9Vr3IAm9RqKERrID9TpXCAGOUH/Wdwz1bkugi/J5ofYWVGYolueCxEpicO2toqVh6ynv8uEmgMtagd8IHq18AjtQKTtJT5mOl5oib6Gg5aS8IHeetFS0+ar/P1OBZIIM8WFdVLvucMYlbjpUQDXDEQQQhJHjmQpAz/FDn12k8PsCMZylS0+jX2FH2r7PZqtBmHp0nmXCawNmIiFTH72uaRoW9rCbHG9s0MMFDcfk+8K/ReCPlOvkvR+oI7+Y1PobSLUd+r79Rqnx5D2iUz+B/R5Wtt09Xmzxox+I+In06mzxRoADZMc7ASbi2LO9uMPQBA6VcFoN/3ekubjQHO5MLGwABB0Rw90Udm4Bt9P59TY/QmhHVLB4QO+XjQjpfvs0/VRjUBb+pDJRNCCIA8mvM3L3LKgs0nfv+qb8vq92tB8uwLgpjDx+QTiJPIE1zi591rNJ0SkaQmhUbKuLvlYO5SU6naQ3EgRfIKXapKknTSRNu/G2J025+qPWgtB1DnRcC2Enl0vxf5E8G3gOLtmSoTcZhIQoe9THIpGMLANkTGXtMh3oKuICVbmB6o/TCSeULtBr7trPMH+Bf+3VpOwoZt8O5QO2CYI8gxrqBwQ65xLc07VMc4cKRDGAQER84qZ2/F5JLDfMCm3DB2T7QbMJw3fazRQFlna/gHTflX3OfNDWr5G3npqWgKorel2ClylqpuAOsYehwiAG0H3QqwyoZqqSgjQkr6JlQchs4qMcuVZDYrgrtLvPLuP71iu+RmbKW04KiRzK+0naqdoMo1vc/eQek9wMknSJloKzQ8tzLJJVr9cTHKRCGV0ex2bP5y3rrmdgOIasfnRRG2JDQFRWt9eJcmCMfIqbUREhucQDi8eg/G8pkbOd8oL5eD6eX66l/aKCdvaZSE4/F6fLAYYXrYcWlLm3ojmdRwjzNecmHfW2DKRopMIprwEngjfTofDvJrE5IzHiURZCctI7VzzvV7TRLtzYq/u5z5tv68m+mH+D8TDYJLTzbSPIafUC2JELEh8h2Tte/AsjrCR+4VvrLDj800jiQZEtjbZ1j8eCHsmoAHD1OLpsvsO+FAJXYcqeSTCO3QNj26+DTjwYDPt4CHCpB4qXxbKvsn/pNKXBEf3XPa+75D0i8gTy5hf3wud5rhW/8XnIBqENttaTVsbWAPjJC5BFu7tuK4qmIQLJQv7QxqKiBz+hYUiEcQ36HsYjJ7DH9dx7tJvpAtG5D+yMS2LIA9tM79uXs1v1jInNL/sJECoTHyq2O0NXagdJKJHzaKiJN2Be+022xLXb0dcHNM38a+VpGI9Oc6n9mMzi9WDZJdZJHVP7ya4nY7MNhCqn/PYMPYGY8JQSYyaRgOMMpO4BuqVkMB2iGXzjkKEurH/yYIPOshRxiHpX7/Y15VgB1yEm/wyJD3b5Exo7Yijr+9zLRR+DpXNV5uBU5g6RwiuA3SMs8R4r9Y1DpYBbQ84vrWuiNZr4JlLCZhUlQ285iMTmsNDPogLVo+2T4XGbjOkAymyOrj/dHqMZdqsH6FJA4lYqi/oWgmNvWWAWXkoT+qGw8DE417uVFDS4VCqiDSeZnqLCTVVznLRfuwxJ4hzLYIATv6kiXK8HccV5+2Fek/Th3folcU+sh2rr2iy6ahOjD9NbmsQoagu6kVXkD6+ObLlxwGJ7okXIy4kWSE+zAgzCRl2+QKj4Oy+bnaU8a8dYDjeo0nCJ5FfofOEcbz2fHL/0AR2ojs25XxMyvplOuFPJebg2iLbTyhVTrxMslECgP3TVtQl7dKU+CDLCScW3RQCwqNIlPC5/IHsOPa7Okfpty/o/hAwofwE2mBZM+todjUTjwLXhEbM/dnI9vPY6x/rnkXjwF7iVSPNkb+j1Ihk6QCd3GNtv9MAcdGnKgj0Pb7JEAIRpFQbxI3uJf80sAct/bQt6rB/8gyc6uGyb/swcixjrchop96JsUYLYZ4Fky1f/b+J2YRGifjpPR9rFJDUOMzuf0Upt7QLhIDjONORGeY4PzVOLCpCCHzPryFoiP1TCv8e7YPFUqy0/C3fdCQiyT+0M5n4URoPWPtKu8xNnajteMzB1LLNQwJazuHsgftwx4B5AyB0BzNYjiDhh8nDfRrF1Dnsc1ETl12j2wdhYjlce76ZNIHrs09UHea5G15TxLhmpKbdYXAHQEJuOrilpi4qByfthUIDz+u7z5MEYJKwOReOZBHSZTJCap2mzzj9HDd6bBFORSrnwPZfClFww2CsHFxPfhOsbXT88EeOFTHsNvSfBJsgXhwlRpFQcPGhE5kxX4sdSEubD9W79PkaXdeJJrhxgBHpmsJqQZKV8USpKLrkGgnBt4lk3DVsDQgtNMG0k4bSaNJ4bT9rW4GpjPZkHgH7HXT6KT7lsdLn6rjna7C2nkdQjFuzQwpgMN+1w2Hfoyft4Wyk3kst6S25nFn+or7jIfpZnJqsOEsuZVtC2FFXM7pQLhyr/rMNUaOxtkDSCI3SeepYNb0UcAMc9pWJAAF5TYkkZLtKNvwGmjZfODGva8Wxz0PXbSBpLSScQERQ0KeK6uatOZvcaHwjGiqQqZ8ayC+NAgxN1/Y5lh0gfWWatZmB0g40K4EL9/zS9u2gwFIwSrBsL7jHjspJGySYQbxIa/R8LTgc4n3LstDJkhBh0n78mRGfkeyJce7RTThAJ8kDO7PtLPnJCP+R/iNHuSlobA+2GRemXW64wUPFY9+u1/mwNvvGkcSP2rdP0tmgbc8WQe7fq6uyeSdCZXUiZSpz+7zAvoDXu8vXIUzryIr7W+G40yRiVp9xeCnXeLO+I+hxoP77dO3rCb5+13fpfz5HSWq+S9qNY+LkYu+H1jhav+83EBBIiB4BdJHBT/q0Pl+35MjWjoYrMyRs6TqTwwWozuQP08n4wUK5qzXvg0GgnQLXwTjEyKIcJF07YsHDEyM0yY0dXX05ZjhadZObtO0sRHa8vxIN5h0XwmRbR7dMlBfb7HJpP4WO0jBzcrhR/W6GTYSM5x6ygq8+1P9L+2VukJiMJIkhbC9AcvJQppz8EJe8yJxx4lJmFn4QD89hu4iyvc7f8zvfjTIvMVfwo1LEMYRZrMdfTeD8nRpgHY/MuJQU5pqi0R8BgRa9tIavzaHhdWN9tZ0Cbqrj9C71SCvSyLzSkLkf44cQ4rmEdGj/pgZ+RzhcEQenbooLl9NP8RvlAy2fZkfCal0+1SCTI30+buk/yoyAkIkiYWoF0V4Qoz5BRKsbQ82QNY2Yw4x0ShB455zm875DyUdHuLQ/P+Cms9H7oAs7n/neiUeYDjMqMY9zBjyz/eUmqFFAKoefkFfGakhS7ywNvVi40YedbCqWv+K5SuA+WQPTcROfw5n5purY2oWHDNEW9XibtsvlE20TOLgjNr5BXzXRRxPm44cyxAmYLHTKwKYm0TTt3MLhYoha0jUWDOV5gJ0Fr6PoXK9zopSF+DxhyUv0+TCfFzdmHCDqYAZqfqibmg2mmHqspXbY6b/qaBSxfLSIy+lF8LRJnXdZCZlyWhQRADhF+zhDjLC/fSHPSf0bZlJL0alHexvvQ9oqQrl7Lmgq8f8wz4gE0dbzFzr+Z3295FnajLqSsP+XljHLksDcbIP5dBS12kOv+3hYAKNxFvAJdyqiepWnJVH7giT6/bFrHFY7cFrDt6CoD+K73SbkYmGTSIICYnW3EN4j7esXWpJdKy2bmIxjuTbKGXbGUdr+lWacWXcNlPMvpswFBQ4m0Su6Mkb5C0tmT9Z72raKoZZgRjjfUn1ORBXPXYc5lxLx29GIe0AV9Pt1nutG1p49KIAmYGE+0jcPhz7YASG6tKMJjy4G4Xu8RgR7mv5HQzaZRnLiHRb2+gsxAgWU0grhfFNOf5x+EyPV9CHGz7jS23kdirQKI6pfK40Tw8SCAWVOOZI2FWtZYBCk6WKBOeyK3pU0P7YC1o4QgVvN5/iQBaYMTvhibw7bR4PstXacyf5iFkUrfx7uT5wen+KtJn6ewR5a4xKNxEgn6HV983q6tsHHQEM0RYadi+K/kv5oH0LkUcIiE5XjTo5fYNUGJshqMqkKHgIgpEtfX9rp5OFVtBAmTArRhsN+jF8d4ZqaEsE/R5ri8c0+xDDSNC4wFHMRvYrHJUx5iWyuqR1FtMO/YShfU1CwquBasc4RImZJ+KZWCx+CCFF38jHyHZ4bjECIt37KBCXtVDrj4CeixzfByUQb8LuX1sq8IhuOueXKAzGbQ8PSbjCScx5iqnEVywUFqwKYLfgUjrvLOSeHweKnqN2iEBNtsDFMrqZGC40Tzys/zc53hICP0HaEijG9WPKLnyJH3DkO6rv4/RiZcvI/9N7fTT272OoFqx9oCncspCARgq7PFjG/WgQe6zHCtHqRBh0H8UnIxL9Kr3R+J7x7vl7lzNfnNjmPY0JDyBzz/nD+nWuBafBfxGD4PKssE16wShD5AJ5qdJrscR44Q8Ro7540dXJSpk00r6YVzimS4Mu3JiJHVLd2RLwbGrNns15xsqPBAH5JymNQxo0JZcKvN+mVpGE8DiEezXySNQrmFPF+wsMO81a7ytQ6XtsR4mW9+1E6xtk77JoSnJwjCKF5ZJ6jopgFXM/3HHNNLB0e+N334hnNHgpWBF5IVd0/EWtRUu3X3b1FWTAKUpzCP29T/UBEtfxtXyBesuLukEhOosltmOCb95sbZ5wydJtbFU21YRAejkPXk/1tmrnpW7MuHWbYLIbnf/Effj/fmmSufpnGmfpemkYain5XEOuOAOFWymWoLBiYazplao6JiKX+VOl3b9NZ3+yhYEUQJS5oh8ESckrLCdMCF/rJhInanA2975cLEEcK8XpNuEyn7oG/Hsd1RAqilpawX3KBiB3ij7oqR7Hqp9l/sbabeljTmocQMA/UIUeCL0KmHDMtfBCcdsK8RLWcN+m8Vq8y36Z2WzDjv62IgABPz231nxKDoBVDED1N408Hfy8MsvJAckdZSHZjxDCYXsnUgrBc7zW5cL/fxYBoUbSZ2WCihyFI1kXLnn2tTRIwu7bgl0gD4CuQs0jFikS92qXoCZhVJCsdvaIgkb7H0kCOZO03GM51+Yp9m/BnnFSkIR/rNHSc5Sq7iELB1orOhkGAw9kDzcc1CoOsPFzxOcQglNN/U7bwM72Nq2rFIBD09gDi91r65niYbm4KIVOIkvacOdqAWRj4Ios1hdgOJiKr3O5KmMNLTh0dk/3vtdmhUaNjiwTFMmiVMLPSA4+akTGIS1bcLC/7vTDIyqPHINWX7I/kN4i+vWS0kwbZHgbBpOEhL6Ma3bFicJykJqu+lJKVcSBXAoONQ3SPGX5MXMzJCdutSQqDPEjhhgesvuOhmDi4LrVPN4ky+tP1/YV+v60MQiVsmFE8pCUeBpQP1pin1X5t7YB/wtheeM1Haz/5sQgxpy7padhRJjBR32wfZnvq5QqDPEhhDYJJUV1pe7z9mAMqjWc6NEl4YJsYBAKgRJ18xhw1VF6v0m5xdFuvvJ8gAEWEhDjj4UFyXPXf7QUFj+yrt18dIw84eBly83wUX7eYY6bm+Yuf0LmTeHylzMCnLtq8a6MwyIMUiUHcqE5OOZWq7fXtlqTbwSBeq7H3k0Vox2lMi9hu1fGSqcWir/U9QsHBjpzLvXEe7sBxtSU8EnwpBMq2/CcaX2zxvvzIAxqhddb5WAkQsLurN9fLU71YrjzXudwNHFi6iyZMgYulojDIgxQDDCJn1EwiAu096akZfN4eH4RwLuvJo+T8SmklWvZIYstpT0tCE/g8SCw8Fu4LOsdXOUm4WLCtI1Nu/5OZjvI12scEJCRtanZ49slHNS7xNQdzbF/DglEMkj/vxQxSolirD20GASweyntxMbaXQcCbkdIiNkK7c5SFjLHrkfhultY7/u0+Nl1EliLB2Zb/mMgdnUr7u0Pf/06z1SBi5eDrpDmo8j3Y57Ici6FCQ7UYpL6ixyCEv4fyJIVBVh6RpKO9/sbezQIsNIo+VHGzloNBgMsqmurcUWsqkonlZtvVpTqufCCe7ruNpg3A1MJ8in3RMf1GfR40sXKYSeQ3bVzzyGVLHBKNi0cW9BnAIe4mOEEHEjfBy3+vz/RvBSsECMSPJrA5dY0d5WTjQ5CsdkyNxJaLQQCaJF/zkcMJtalHW6JCnDydieZxeQvNpcL78bMwjnM+xNJax1hIMyDxl0Nz5PAa+szUcwmPe569WczwGb02z+BoBou8ysKsFUS3w+MW0gMg6UC4WYTTzzk4PNs8T9BNCjrRF3hnwmXwU4/dLkmOZmQfy5UV31a4QfeIh6FGEIRnVPJA0YxBCBQ0TyEuWAGEWp/Rzdiim3S13q/Td4POqKNa9axHqS7dfkST7Qs1r5/SK34WfYTXSVg9qtHmtJLdHIMO//UBzT8LdjowozCz0hglpTG5yED79+3wAwr6YJ7Rzm7KfdDDe2Ytmi6/HzH6fmFBQUFBQUFBQUFBQUFBQUFBQUFBQUFBQUFBQUFBQUFBQUFBQUFBQUFBQUFBQUFBQUFBQUFBQUFBQUFBQUFBQUFBQUFBQUFBQUFBQcF2YmLi7wAJSteLNWbtPwAAAABJRU5ErkJggg=="  alt=""> -->
            </td>
        </tr>
    </table>

    <br>

    <table width='100%'>
      <form action="https://wa.me/6285738215595?text=Assalamualaikum%2cPerkenalkan%20Saya%20...%20ingin%20bertanya%20perihal%20pengaturan%20Jam%20Waktu%20Sholat%20Digital%3f%20Terima%20Kasih%2e">
        <tr>
          <td>
            <p>jika terdapat kendala dalam pengaturan JWS silakan hubungi author dengan klik tautan berikut</p>
            <input type="submit" value="Chat Whatsapp" style="background-color: #25D366;"/>
          </td>
        </tr>
    </form>
    </table> 




<div class='info'>
  <span id='day'></span>/<span id='month'></span>/<span id='year'></span><span> </span>
  <span id='hour'></span>:<span id='minute'></span>:<span id='second'></span><span> </span>
  <span id='temp'></span><span>C</span><br><br>
</div>

<h2>Ubah Waktu</h2>

<table width='100%'>
  <tr>
      <td colspan="2">
          <h3>Selaraskan Otomatis</h3>
      </td>
  </tr>
  <tr>
      <td colspan="2">
          <button onclick="selaraskan()" style="background-color: #8affff">Selaraskan</button>
      </td>
  </tr>
  <tr>
      <td colspan="2">
          <h3>Atur Manual</h3>
      </td>
  </tr>
  <tr>
    <td>
      <form>
        <h4>Tanggal</h4>  
        <input type='date' name='date' min='2019-01-01'><br><br>
        <input type='submit' value='Ubah Tanggal'> 
      </form>  
    </td>
    <td>
      <form>  
        <h4>Jam</h4>
        <input type='TIME' name='time'><br><br>
        <input type='submit' value='Ubah Jam'> 
      </form>
    </td>
  </tr>
</table>
<table width='100%'> 

</table>
<br><br>
<hr/>
<br><br>
<h2>Jadwal Sholat Hari Ini</h2>
<div align="center">
      <table style="border: 1px solid" class="ws">
        <tr>
          <td>Imsyak</td>
          <td id="wsim">0:0:0</td>
        </tr>
        <tr>
          <td>Shubuh</td>
          <td id="wssh">0:0:0</td>
        </tr>
        <tr>
          <td>Terbit</td>
          <td id="wstr">0:0:0</td>
        </tr>
        <tr>
          <td>Dhuha</td>
          <td id="wsdh">0:0:0</td>
        </tr>
        <tr>
          <td>Dzuhur</td>
          <td id="wsdz">0:0:0</td>
        </tr>
        <tr>
          <td>Ashar</td>
          <td id="wsas">0:0:0</td>
        </tr>
        <tr>
          <td>Maghrib</td>
          <td id="wsma">0:0:0</td>
        </tr>
        <tr>
          <td>Isya</td>
          <td id="wsis">0:0:0</td>
        </tr>
      </table>
</div>


<br>
<hr/>
<br><br>
<h2>Setting JWS</h2>
<h3>Iqomah</h3>

<form>
<table width='100%'>
  <tr>
    <td>
      <label for="iqmhs">Subuh</label><br>
      <input id="iqmhs" placeholder="12" maxlength="2" size="3"/>
    </td>
    <td>
      <label for="iqmhd">Dzuhur</label><br>
      <input id="iqmhd" placeholder="8" maxlength="2" size="3"/>
    </td>
    <td>
      <label for="iqmha">Ashar</label><br>
      <input id="iqmha" placeholder="6" maxlength="2" size="3"/>
    </td>
  </tr>
  <tr>
    <td>
      <label for="iqmhm">Maghrib</label><br>
      <input id="iqmhm" placeholder="5" maxlength="2" size="3"/>
    </td>
    <td>
      <label for="iqmhi">Isya</label><br>
      <input id="iqmhi" placeholder="5" maxlength="2" size="3"/>
    </td>
    <td>
      <label for="durasiadzan">Adzan</label><br>
      <input id="durasiadzan" placeholder="2" maxlength="2" size="3"/>
    </td>
  </tr>
</table>
<table width='100%'>
  
  <tr >
    <td style="width: 33%">
      <label for="ihti">Ihtiyati</label><br>
      <input id="ihti" placeholder="2" maxlength="2" size="3"/>
    </td>
    <td style="width: 33%">
      <label for="durasikutnah">Durasi Kutbah</label><br>
      <input id="durasikutbah" placeholder="45" maxlength="3" size="3"/>
    </td>
    <td style="width: 33%">
      <label for="hijriah">Koreksi Hijriah</label><br>
      <input type="number" id="koreksihjr" placeholder="0" size="3" min="-3" max="3"/>
    </td>
  </tr>
    
  
  <tr>
      <td colspan="3">
            <label class="form-switch"><input type="checkbox" name="iqomah" id="dispiqomah"><i></i> Tampil Iqomah </label><br><br>
            <label class="form-switch"><input type="checkbox" name="imsyak" id="dispimsyak"><i></i> Tampil Imsyak </label><br><br>
            <label class="form-switch"><input type="checkbox" name="Aimsyak" id="ringimsyak"><i></i> Aktifkan Alarm Imsyak </label><br><br>
            <label class="form-switch"><input type="checkbox" name="disppuasa" id="disppuasa" checked><i></i> Tampilkan pengingat puasa </label><br><br>
            <label class="form-switch"><input type="checkbox" name="dispdhuha" id="dispdhuha"><i></i> Tampilkan Waktu Dhuha </label><br><br>
            <label class="form-switch"><input type="checkbox" name="iden" id="dispiden" checked><i></i> Tampilkan Identitas </label><br><br>
      </td>
  </tr>
</table>
<br>
<div>
  <button onClick="setJws()"> Simpan </button>
</div>
</form>
<br><br>
<button onclick="ceklokasi()">Cek Lokasi</button>
<p id="tampil"></p>
<br><br>
<hr/>
<br><br>


<h3>Informasi</h3>
<form>
  <div>
    <label for="namamasjid">Nama Masjid</label><br>
    <textarea rows="3" id="namamasjid" placeholder="Musholla Al-Istiqomah"></textarea>
  </div>
  <div>
    <label for="informasi">Informasi Tambahan</label><br>
    <textarea rows="3" id="informasi" placeholder="belum diisi"></textarea>
  </div>
  <div>
    <br>
    <button onClick="setJws()"> Simpan </button>
  </div>
</form>

<br><br>
<hr/>
<br><br>



<h2>Volume</h2>
<table width='100%'> 
    <tr>
        <td>
           <!-- <input type="range" min="0" max="150" id="bright" onchange="setBr()" style="width: 100%;"> -->
           <label for="bright"><h3>Tester</h3></label>
           <input type="range" min="0" max="30" id="bright" onchange="setBr()" style="width: 100%;">
        </td>
    </tr>
    <tr>
      <td>
        <label for="vol_adzan"><h3>Adzan</h3></label>
         <!-- <input type="range" min="0" max="150" id="bright" onchange="setBr()" style="width: 100%;"> -->
         <input type="range" min="0" max="30" id="vol_adzan" onchange="setBr()" style="width: 100%;">
      </td>
    </tr>
    <tr>
      <td>
        <label for="murrotal_siang"><h3>Murrotal Siang</h3></label>
         <!-- <input type="range" min="0" max="150" id="bright" onchange="setBr()" style="width: 100%;"> -->
         <input type="range" min="0" max="30" id="murrotal_siang" onchange="setBr()" style="width: 100%;">
      </td>
    </tr>
    <tr>
      <td>
        <label for="murrotal_siang"><h3>Murrotal Malam</h3></label>
         <!-- <input type="range" min="0" max="150" id="bright" onchange="setBr()" style="width: 100%;"> -->
         <input type="range" min="0" max="30" id="murrotal_malam" onchange="setBr()" style="width: 100%;">
      </td>
    </tr>
    <tr>
      <td>
        <label for="murrotal_siang"><h3>Hadist</h3></label>
         <!-- <input type="range" min="0" max="150" id="bright" onchange="setBr()" style="width: 100%;"> -->
         <input type="range" min="0" max="30" id="hadist" onchange="setBr()" style="width: 100%;">
      </td>
    </tr>
  
</table>




<br>
<hr/>
<br><br>


</body>

<script>
    let x = document.getElementById("tampil");

    function ceklokasi() {
        if (navigator.geolocation) {
            navigator.geolocation.getCurrentPosition(showPosition);
        } else { 
            x.innerHTML = "Geolocation is not supported by this browser.";
        }
    }
    function showPosition(position) {
        x.innerHTML = "Latitude: " + position.coords.latitude + 
        "<br>Longitude: " + position.coords.longitude;
    }
</script>


<script>

var xmlHttp=createXmlHttpObject();
//var xmlHttp=createXmlHttpObject();

function createXmlHttpObject(){
 if(window.XMLHttpRequest){
    xmlHttp=new XMLHttpRequest();
 }else{
    xmlHttp=new ActiveXObject('Microsoft.XMLHTTP');// code for IE6, IE5
 }
 return xmlHttp;
}

function updateData() {
  prosesdatajws();
  proseswaktu();
}

function proseswaktu(){
 if(xmlHttp.readyState==0 || xmlHttp.readyState==4){
   xmlHttp.open('POST','xmlwaktu',true);
   xmlHttp.onreadystatechange=handleServerResponseWaktu;
   xmlHttp.send(null);
 }
 setTimeout('proseswaktu()',1000);
}

function cekws(){
  document.getElementById('wsim').innerHTML="masuk";
}

function prosesdatajws(){
 if(xmlHttp.readyState==0 || xmlHttp.readyState==4){
   xmlHttp.open('PUT','xmldatajws',true);
   xmlHttp.onreadystatechange=handleServerResponseDataJWS;
   xmlHttp.send(null);
 }
}

function setBr(){
    let br = document.getElementById('bright').value
    let vol_adzan = document.getElementById('vol_adzan').value
    let murrotal_siang = document.getElementById('murrotal_siang').value
    let murrotal_malam = document.getElementById('murrotal_malam').value
    let hadist = document.getElementById('hadist').value

    console.log(br)
    
    let dataJson = {cerah:br, vol_adzan:vol_adzan, murrotal_siang:murrotal_siang, murrotal_malam:murrotal_malam, hadist:hadist}


    var xhr = new XMLHttpRequest();
    var url = "/kecerahan";

    xhr.onreadystatechange = function() {
        if(this.onreadyState == 4  && this.status == 200) {
        console.log(xhr.responseText);
        console.log("hahah");
        }
    };
    xhr.open("POST", url, true);
    xhr.send(JSON.stringify(dataJson));
    xhr.onloadend = function(){
        console.log(xhr.status);
        if(this.status == 200) {
        var myObj = JSON.parse(this.responseText);
        console.log(myObj);
        }else{
        setBr();
        }

    }

    console.log(dataJson)
}


function handleServerResponseWaktu(){
  
 if(xmlHttp.readyState==4 && xmlHttp.status==200){
   var data = xmlHttp.responseText;
   var myObj = JSON.parse(data);
   document.getElementById('year').innerHTML=myObj.rTah;
   document.getElementById('month').innerHTML=myObj.rBul;
   document.getElementById('day').innerHTML=myObj.rTgl;
   document.getElementById('hour').innerHTML=myObj.rJam;
   document.getElementById('minute').innerHTML=myObj.rMen;
   document.getElementById('second').innerHTML=myObj.rDet;
   document.getElementById('temp').innerHTML=myObj.rSuhu;
   
 }
 
}


function handleServerResponseDataJWS(){
  
 if(xmlHttp.readyState==4 && xmlHttp.status==200){
   let data = xmlHttp.responseText;
   console.log(data);
   var myObj = JSON.parse(data);
   document.getElementById('dispiqomah').checked=!!myObj.dispiqomah;
   document.getElementById('iqmhs').value=myObj.IqomahSubuh;
   document.getElementById('iqmhd').value=myObj.IqomahDzuhur;
   document.getElementById('iqmha').value=myObj.IqomahAshar;
   document.getElementById('iqmhm').value=myObj.IqomahMaghrib;
   document.getElementById('iqmhi').value=myObj.IqomahIsya;
   document.getElementById('durasiadzan').value=myObj.DurasiAdzan;
   document.getElementById('ihti').value=myObj.Ihtiyati;

   document.getElementById('koreksihjr').value=myObj.koreksihjr;
   document.getElementById('dispimsyak').checked=!!myObj.dispimsyak;
   document.getElementById('ringimsyak').checked=!!myObj.ringimsyak;
   document.getElementById('disppuasa').checked=!!myObj.disppuasa;
   document.getElementById('dispiden').checked=!!myObj.dispiden;
   document.getElementById('dispdhuha').checked=!!myObj.dispdhuha;

   document.getElementById('namamasjid').value=myObj.NamaMasjid;
   document.getElementById('informasi').value=myObj.informasi;
   document.getElementById('durasikutbah').value=myObj.durasikutbah;

   document.getElementById('wsim').innerHTML=myObj.wsim;
   document.getElementById('wssh').innerHTML=myObj.wssh;
   document.getElementById('wstr').innerHTML=myObj.wstr;
   document.getElementById('wsdh').innerHTML=myObj.wsdh;
   document.getElementById('wsdz').innerHTML=myObj.wsdz;
   document.getElementById('wsas').innerHTML=myObj.wsas;
   document.getElementById('wsma').innerHTML=myObj.wsma;
   document.getElementById('wsis').innerHTML=myObj.wsis;

   document.getElementById('bright').value=myObj.br;
   document.getElementById('vol_adzan').value=myObj.vol_adzan;
   document.getElementById('murrotal_siang').value=myObj.murrotal_siang;
   document.getElementById('murrotal_malam').value=myObj.murrotal_malam;
   document.getElementById('hadist').value=myObj.hadist;
  //  document.getElementById('bright').value=myObj.br;

 }
 
}

function selaraskan(){
    var now = new Date();
    let tgl = now.getDate();
    let bulan = now.getMonth();
    let tahun = now.getFullYear();
    let hari = now.getDay();
    let jam = now.getHours();
    let menit = now.getMinutes();
    let detik = now.getSeconds();
    let dataJson = {jam:jam, menit:menit, detik:detik, hari:hari, tgl:tgl, bulan:bulan+1, tahun:tahun}


    var xhr = new XMLHttpRequest();
    var url = "/selaraskan";

    xhr.onreadystatechange = function() {
        if(this.onreadyState == 4  && this.status == 200) {
        console.log(xhr.responseText);
        console.log("hahah");
        }
    };
    xhr.open("POST", url, true);
    xhr.send(JSON.stringify(dataJson));
    xhr.onloadend = function(){
        console.log(xhr.status);
        if(this.status == 200) {
        var myObj = JSON.parse(this.responseText);
        console.log(myObj);
        }else{
        selaraskan();
        }

    }

    console.log(dataJson)
}


function setJws() {
  
  console.log("tombol telah ditekan!");
  var dispiqomah = document.getElementById("dispiqomah").checked;
  var iqmhs = document.getElementById("iqmhs").value;
  var iqmhd = document.getElementById("iqmhd").value;
  var iqmha = document.getElementById("iqmha").value;
  var iqmhm = document.getElementById("iqmhm").value;
  var iqmhi = document.getElementById("iqmhi").value;
  var durasiadzan = document.getElementById("durasiadzan").value;
  var ihti = document.getElementById("ihti").value;
  let koreksihjr = document.getElementById("koreksihjr").value;
  let dispimsyak = document.getElementById("dispimsyak").checked;
  let ringimsyak = document.getElementById("ringimsyak").checked;
  let disppuasa = document.getElementById("disppuasa").checked;
  let dispiden = document.getElementById("dispiden").checked;
  let dispdhuha = document.getElementById("dispdhuha").checked;
  var namamasjid = document.getElementById("namamasjid").value;
  let informasi = document.getElementById("informasi").value;
  var durasikutbah = document.getElementById("durasikutbah").value;
  
  var datajws = {
    dispiqomah:dispiqomah, 
    iqmhs:iqmhs, 
    iqmhd:iqmhd, 
    iqmha:iqmha, 
    iqmhm:iqmhm, 
    iqmhi:iqmhi, 
    durasiadzan:durasiadzan, 
    ihti:ihti, 
    koreksihjr:koreksihjr, 
    dispimsyak:dispimsyak, 
    ringimsyak:ringimsyak, 
    disppuasa:disppuasa, 
    dispiden:dispiden, 
    dispdhuha:dispdhuha, 
    namamasjid:namamasjid, 
    informasi:informasi, 
    durasikutbah:durasikutbah};
  console.log(datajws);
  var xhr = new XMLHttpRequest();
  var url = "/simpandatajws";
  
  xhr.onreadystatechange = function() {
    if(this.onreadyState == 4  && this.status == 200) {
      console.log(xhr.responseText);
    }
  };
  xhr.open("POST", url, true);
  xhr.send(JSON.stringify(datajws));
  
  
};


</script>

</html>

)=====";


char halamanadmin[] PROGMEM = R"=====(

<!DOCTYPE html>
<html lang="en">
<head>
    <title>JAM WAKTU SHOLAT DIGITAL</title>
    <meta charset="UTF-8">
    <meta http-equiv="X-UA-Compatible" content="IE=edge">
    <meta name="viewport" content="width=device-width, initial-scale=1.0">
    <title>Document</title>

    <style> body { width: 97% ; text-align: center; } input, select, button, textarea { max-width: 100% ; margin: 5px; padding: 5px; border-radius: 7px; } meter, progress, output { max-width: 100% ; } h1 { color: grey; } .note { color: #555; font-size:1em;} .info { background-color: #eee; border-radius: 3px; padding-top: 17px; margin: 5px;} .tombol { background-color: #ccc; margin: 20px; padding: 10px; border-radius: 10px; text-decoration: none;}</style>
    <style>


        .ws table {
        font-family: arial, sans-serif;
        border-collapse: collapse;
        width: 100%;
        }

        .ws td, th {
        border: 1px solid #dddddd;
        text-align: left;
        padding: 8px;
        }

        .ws tr:nth-child(even) {
        background-color: #dddddd;
        }

    </style>
</head>
<body onload='updateData()'>
    <table width='100%'>
        <tr>
            <td>
                <img width='100' height='80' src="data:image/png;base64,iVBORw0KGgoAAAANSUhEUgAAAMgAAACHCAYAAABTVhYnAAAABGdBTUEAALGPC/xhBQAAACBjSFJNAAB6JgAAgIQAAPoAAACA6AAAdTAAAOpgAAA6mAAAF3CculE8AAAACXBIWXMAAA7DAAAOwwHHb6hkAAAAB3RJTUUH5QQMATEqKS+dugAANXlJREFUeF7tnQm4ZVV1518PSQ9p2+50utNtd9KDdhtth44oqIg4ocU75z5mRIgBASlQGVRASgUKCkQEGQSh6t03VDGoiFFR2igaDaJGJYgiihgcoRVt2zbGGOKQ5P/7r7Pv3ffce1+9V/Wq3iPs//ft707nnmGfNa+115koKCgoKCgoKCgoKCgoKCgoKCgoKCgoKCgoKCgoKCgoKCgoKCgoKCgoKCgoKHiI4eo1/3JifvJ/TZx55j9svikoKOhhtn7GxEy9eaL7/F9vvikoKOihW58xMV3dr7FH801BQYGxqf6NiW71x2KSv52Yqc5qvi0oeAhi0zG/MnHpmn/iMb/nP/XrdKcWc/wwGKT+5MTM5H/2b+l3xjsP+kfNHgoK/h6jW+0iLXGpxtvEDNfr83vFGHdMTNd/YwbpVj/V+4/p/bv1/jq9XqNx2sRV+/27Zg8FBX+PcflB/0KMcayI/1vBEFsbMr1mJp9ZNEjBQwd/O/EPRPTPFqN8XAzwy5GMMV3/RL9vmpjf5780/yooeIhhvv6dYJI2c1S/EOO8ydqmoOAhi03Pe7iY4aYhBgmtclqzVUHBQxSb6qeIQf5Pwxg/0vuv6PXn/jxTvd/Z9YKCBxU21f984sw9/3HzKYBPsS2YqV9mhpiuvzgxW/3+xMzUo/X5jWKUH2h8e6LbeUKz5fbjqr1+bei8CwqWHTNTzxQxH2f/gPwEJSJb9v4fza+Lx3UH/jMxw7Q0xbUTc3s/vvl2YuKdB/2q9r+fo1cwzbaA/Mlc5znOp4CZvZ+s83ylzv1h/lxQsMPQrXYVUf+ZRtcEDiHjbC8VmE+zU8+bmN/nXzXfDGJaTDe3z9O3qXiR/+DDdKtbdJ5n6fVzjogVDVKwwzFXP0kE9w0RYDjUq5XwYOTp+rv986wusnYqKNghwJyaqaYiLJvnLqoPyVd4VLPV1kHCD/OMzDg+x2b5GZhps1O7SRM9d2KzCHu+s7t/w3RDw+D3LMXPgWG79dEaP8rO8//qPC8oeZWCHYNrq38tQn6JGOQyjT91achMdb/e3z0x09k4sXG//9BsOQz8jenOf238l/3sD8yJgGc7G/T+5drHmXr/ar0/TeN1en+Sxul6f4J+e5WO89KJuWpSBL67y+Fh1nFwErLeV0zxab3eo9cH5PD/f71/Z2Nu7brNQYWCgkVhtnOwzZfZzlEi+P8mX+HxE1eIgXJ8TFJ8fvLfWyt0O6/wtjP1xXa8Z+oLzRjBEMEsM1MnatsX67eTxXBHaPv1zX8u1ND3nUu1n8P1etbE/NRB0jS7TMyu+bfN0fpAQ6HRZqce6zFTf1CMcdPEln3/TbNFQcEOhgmvutxl6m1g52PGzFYHTsx11onIj9O4IDSGGALinq+e5dWDaB1MLZtce/2aB+YUWgKCxsyC+UIjHBoMJU0DE8FAZqipaiSjJMxMHSKtsa6sVCzYeUgmU26qQIBojLn6hSLeMJEg5PnO8Xo9QAT/GPsT21p0iFnF/vFVMLls7nUu0nGkxWSKzXfWmMHa2HTQw8Vkv9V8KihYAcAwhGxtKoloeZ2T7zBX7WFtsDWmgLkwyRhsuzUfIZlRXTEFPop9GZluMCZOf0HBqgFm0pzMn5n67MbXOFUS/RmW3KOACYZEZ2ktRN2VU96t3qz/b9LrjF6v0HdvNOFPY6bVT7IpN8pEglGm1/wnO/BznfP0v7X2Zbqd/fVakoIFKwyIl7Uds/W5Ygx8jYNtBrUBIc9V/12/HyUi3iIT6QsOu05Xf63PTRi2NbyAqvqp3t+n11uCiSarkQunWKWIRpmDQcQoZrzqcDny/7HZ4qEJNDHzjkk6M/Xk5tuCbQKTSUQKJ3lrMMHXTxExnqNxhJjk9SHpRag5+Bw+w0UanxWx3yrC/+aCjDFyVH+h16/q9Rs61se1rxNH5jPIzs9VLxDDvkEMs07bHTaxpf7t5tetg23HZfYfTLBm7fxPzdkZGndo3n5pAVMCFdsBIkHd6q2OUC0EE71MKAjQJpUcZBz2NrqTjzFjdOsvatygcaiY77d1jF30/t0OExN+7VZ/ooE2+YG+F/PUP9H4msbH9Pv79BsrD2e9v65MqVim+z39fqu+XzsUvuX8YN45m3uYbi9bVHIQAdGtTtVxfq/55sEHzFcvaa7P19zcrRECZrr+f3p9SbNVwaIBcXlCXUW7VhP5XRHI/s2vo9GtnmVTCeKb7bxoyKRymFbmDdqiW31E2xzsdR+AXElX5th0/Rl/j8TfvO8jxQjvsCaKvMXV+t8G/4eiw2AKFlWdZunuGi79l2SlTbDqPXr/tKGIGuFhBw0ICZN8lHZcCOzXDFl/1CHo2eqJZsoHQ/2WgyT0Fasu19x+U9eQGOP7+u5tnkO2KVgiIG6cYmeckeLOjkui15fouxcPmRsk52bqU0TMZ2m7w5xdzzEz9Qj9fpn28zXt7/SJKzJ/wXmNaqOP05XWSbmLyHNc7/9C2C6Brz6g1+dq7Ov9xDqRn2lMu0IXf4cMfiKErs5/pjpyKMMe+z5F2/+e/9NmZphqZup3fQwYM7TYz7Svb2l8Vkyy37KbJZw/RZiLMWW3BvJH3c5eOv95nfd3svm4T+fflWZ/zsjQd8ESgPnRrT/Ym1yWu87IvJnt1AMEh8NLcg7tgFk1zBxoobdrfF437VPax8mWxBCCb2R1gcbnNDbo5l2u8Qm9l5nmCBbaYH0QKeaVfBSbBdVfxvnIFJup7tTnb+tVDmd1nt7jwCMl/0rvv6Ht9Ft9ps5jMHoVtV7najRJSmmlHDb7rNX6hY3T1Y99nOXSHtZoOMsIF1/rNyzxtxUIrunOPtrXO3WuMHXDGNXXdd6X6vunLViOU7AEMJFu+dmb5LuG/BAIfJ7kHJEqmSvt6FCYRv9b40JLyLCDT9HrvLTNnF5nTPDhU/yJiT6Ox+pBNENz7BEjtr25OUdCwh/RfrRPmXCur5Jptom17Tq/8HfeaHMph0v0qeni/KYqO7E5+OzOjk3roWDOZzW/bjtgsJnqcdrXeu1T55aKPKmG1hwtFUTw8OW69Y3a358350q07y5d2xtCILUCJVwb2rt9zQWLBJOKxgiHmvUdX/JNTeAmUxoCcTkrLpMkh4sQxRz0r0oOs00XTCRJs1wyb40ZRo+fa18/1H6+r3O7U+/FFPUf6DyeOWRXY25gGlGUmP9mxx2JK2bCeW8v8PL5Sis5/CwmpH4LrdImtsXCuZ76KTpfaU2ib821UDSJz9StO0vaNwIpqpM/qv//ZbM/hMvtOufXhq80xhRkMRravPgg2wjXO9VPsoTBPOlWr9DYtfk1bGabLg7nHtB8GyBLTl6DKFVavYe2wR8IprlXIyf2pQ3MJ/wBfBKcdBjZjvfUIUPnktCdXKNtP6/fjx0gGkzCKIFZLyY5fMA2x+yieHJu8un+jO9EFcBS7XeIkASok51536/qe7qOa/U6OaTdxgGmtfCpTtTAL3yg2d8D/sz3BB7y4MQocM3TuraCZQKSLTmQvBIxiijQSQNOe5gPkl6YP1PP1qjCXIORJOkdCrZp0XRM3IYR7X8kMWVW4WB7sVa91pn4mc5r7D+MQkhb+UItMwlTEP8pfJI9e8SFcICxtxUIlunqBTrmFr3e73OPca+YhQqBZ/XmdGvgXNwOyXN7e8wB+/I8/JHeH73oBCj3yw58Z/fmm1WObuc3NVH9Clirdkvol5nIVhvQLlGJu1bEtVvzbQATijUXECwOcLdzlYkYf6NbvctEHG1D+wS/rQNNktanJ+fT5SX1C/2+DSQ5OR00Tx65gqnN8GT0pUXGlcMsFoStibQRhYtcQzrfr+n14onZyd0W7SwjmKZl7mLa4VP0BQuLvsgjvXAo57M1uNKheu/ExheMX6uz08FN4MRyaQsjYHcSz2f9QwLrrqOruezJal3z7eqAzQ5Xyr5ExPSKAZvZ+ZP63Zr8s2y6UN7RFVFExvzruk4c9rN1k+U3NESzvYOwZb5kFkHDXI4quQcRNfqM5vXUATPEpfhyyPGpaOywNRNlFLwasjrM15k7yzP1lzUX5ziHQuHlYsA8E3XCXyMK1btmwuHVdfr+SO3vefpO9ONjvtgRLDq+tCNybUx3XqT/ydycfLa3b6/ZWRG45qi+ZGCNgkOp1W2+8NnOm3o3BdVrCVH9UhM8bCfCbNQYjSOCHQkTWOesIKbMaQeEegmF2v9wxOpVep9s5B00NH/MIyUUSH78C0w/Mt9tIud3fBQcdkeP5MQmsO0cxDZ15MScxlL8DAoju9Ux2vfH9Jo5yw5fr7NptJS8CSYi/kq/NxjjOzrvOdEJxK3rk2Pu3308ghwaNrfwzS5Y8IFD0JRD5t7/3TrWc5tfVhCRRT5jYKJYy00JBRNAOXj6DTs42v7/TN8f4e8AkpKmag5LOoT3suaX5UVOWG0ic3LNq/+O1bn07eeQnjfp+0/qWr+k6yJzy9LWdIOXf7h2q7qlOZ/ne17Cv+HYt/Zscl5Dym7W7/PePsLCZw3cD4ROMD9h44XDrcwLznBX2gqTsl9HJmfZj2o43s70tmCmc3yzLw0nJy/Xue0ec2zGWbhmzTmgBUpIMCdjG7a/d6vXusNhdUkSrBVhCU5Osf+32BEDdC0PBnnASSzboSkKUt/X/OcOq1iAPRthWZobbHulqrPavrFPNeG4GYMYFI0F8JWckOtcOjGvbXJEmcftksC/q21wJAdv2o4ZhDTP9flyntZeMkHcfqj+A/12aHMub9fny3RtVc+/YPtu9akBIg6zplneq3lvCwfAPYr8zut1/z7fv3+W3pTQHKX/PqLZetswUx2ifZI4JIm6S8+MpY/XoLO/wJCvle4b18y9S4j7eJ7m4Fq9HrZof2iHwSpT0pUbmYOkWXK6YKDEIEiLyIQijS7Wb3PaDrtdGkUTh+mC2mbibPdXb9L4lrb5c/3vJh2v348KKU9J89bCiPwOk4a6ng0p6zKFu3umiNd7kw8gItWEbwGE1a2u8k2J7Pi8r4vchNdwVHf2rnO5h7P7kuTTOj5+Duc+U/+h3n9C470aJ5pp20RgrYJJ1JK0RNli+e6xA+Ywcx3O7Xk61ley6/mRvnu/xiGa6+UxeQkmcH6JwBMIVYcJq+M6uSgh6gLNpA3yeYm2S0TSbHEQMJApmACt5b7bigJnK0oeLtMNeLlrbuL7PoOY43MTq1cqgJSUHc/aBwoH5cBvmny63l8cnxt7cnByzu5JP8J/dpCrg/yZGw1xtx05fo/ycf6P2o0eV74hujHsz+u8bf+u7TEzgIFchNhZo//tqvf3+pxwBkGEJymOy9oCLdNwToQEHgKCLiXOKxxuST4/dYiPPw7kcfCX8rlw9LDzWjnqcqqbyoEoEZfwaObEw5rqHRpTA4GXHYnZem8dV/fIguAM0wlahRq29CSu/vmtNz0Rho+HD0Fnb1mdNVg43c6W6sRRyUgof4/92iszuNJhtygZ+LC380XBGHI4Xd3KszMoNqu/698xL2aqc+L/+ZA0RTogicLUgOivtzbhpjvzKmLOwXEhNhOciwe/1OwrQqLsLwr8ThKjDIaeOT/3wRKjmEB9Hjjnr9MxaUR9oL6/XK/jbGeZZvYPpGmSybKUoTl0kaI0adJsjkqJSTbtMj4zjaa2FpHvkQCz0PSBKF1azx61ZOl4jbM89bwFcyQIlNy/WQ5EoeYHzRi5+RcmWb/XF7Tm/EvnCfrc9wP9fWef5l+rCJH5ZGEQJ0pFaySqUpNmnzz2bH2zfqPYDo1BBOuvdJOP88UigYmpm8jImMpXILOLdDMTOJoRE0H9DbC5U98Y+8d2xXSTmdd1acOVPdsWhANIb6tTmnDtWm+TIlVcg9vrIHWz6E/4KpSjvFvjLT7ndB7hE4QJMED4XJttaSIvCIg32k52wq+6Tb99W99lzd0WGAgRCBYfLCcaQpfM3UKmpX0umWE8CzGBfcyxNBfTdurIqAqgDARnWfPDHLa1bxuOljVNKZYT+DZ5O1cEHibiQBhYA1pxMjCrI+v/9trm36sIVnWTu+lGHOXXvimFagwG8XDJN0tPT9SFfVefIR5qdn7UEN5H9duRnqgckRk9Xb/TDO0HPefdvkEm/dAMSKEourtrYvOaR3q7BLZPRAbz5AxkM8m27LEikr7D52yxy0fQGIusqfJ1yVdwcSFd3MX4YvJptKMcbGtRR/2+E+dKlMhPlmIb6qLYD/N2gwhR2k4M62uVj5Tsaj5TfrJQ4zrMxLimk5tvAgQg0CCUnlwrRmP/5DDy+RgH1quwLCAE2S0LHn97EPfjCs1L5Fv6c/vHthLCF5RWz35DYK1KDdIGE475EesZ0gUQGny2HU4zSM8kwym7Ud+NdwIt3cUIIS229OxMCCB8lTRB94ugZJKJEYPhRmec22A/lLlbg0ydOGDH4ky6fKN3HYsdd+t6K72iefrfwxD4bMBLQ91g+mS9XhmazeYc2pJixVN65+IQrRzTlCH3tet8ydsshG51nPZ18UACj33NSqvRFWUpBI7gwx9IWpR7h9+2nIigzDE6RmvObXm8vec3ISCikXi2jQQslsKqBSUaXrNgrYDkZBlpqEAkqAsCySNYGjPBrHk4Z6yZABGw+MWmmfdxqyVdDogoJHaaJKRyYwZlocBxgCnJF5B3gVGRynn0wyYeyane/pcwKHcn8QXDpjUhnTnNUzQSCMb/sIj1Rr2PCCDayz6U/u81Is33SHqSaJt1Pgl8bs9HG/FIhXkTVELkTQhnHzFgTm4NmGMRGUvX9z37C1sD9xFGxxLgNTcVE9DUnKuLPZs1L3EMVk/eoms9aigjHiX1FDRiPUgzV5PNL6sQ5mg5ouF4ozmQjuv12jCDifZneqUM/Aa9Etb9uS98FKK+aZ22obsHTuoHRbxPaX7tAwLsMURrkLcYV9gHQgMRtcpMJxKU1WG9MmmkfZiGg/tezAgf5QLtj964kayal92OL5LgKl37XP2wMlEmm1g+boRpOVcWQVGHlZgeX6JdKwYgQEwQM4J8uRQIcfia+rfJ1+iVhOdtGq/WHNZm2ghWjF8/QSjZtV6+Ps7vTb15agNGIAIVKyWv1PayEsxc8hmZE5nCOdO6TL63dgQfFYGFOX7IgjVVEYi4THO9R4/xYOTFmIs7FUjdKBk/VRf1OEs2S9DGeY11wiQTRXBS8ekZ4YSFc4Rj1tF/P6JXbgKlBaePNQVIOobPgdNP04PMZpX0gdgxn9AEbZBPiRvRJ2pGhFMvNXNhFiZzMH673yPffqHh3E39Zb0Pcw8Cz9eWRH6mM9CFxD2uMF8IDmiumFuvvSbIQO6j+f/MFF3nw1wLCfxEfX6x/vtm7ZPgBXMcgiiECK9/49E7P92f0PT4hARaLnaYfZzmhdG9Hl5MNsokRks4qkeTiV7Sd9S8QA/n9bQCzBfry4/U/j+k/588wEALIT9XJ6F1fovRbDsdXFCsYqMk4usDNwJpkKQNdqLzCvo+OZDWQFNk2FlnQYII6TltKbQQMOtiuSpLZrHlYdK/8LFDW8lHaTLAbYQvxA2EcCDkjHB4z7PKbTJyPlESsWmfp1vitiMrCw0c82QKtRkEYHcn2xoQag5JerNzSkTPQuITZWPNxS6eL5egYCrpOmAIomPjQ81LGffq+l9uxmwDPwSmToGYBDSPiwNFnOFXjtrv4AhHf92A1oq1Np/0tfjaxPiLhQVvMrlkzYzTbisGbhgFYkF0n9cFvl+vyd/Y2OP0sPvjQqKbIHVGMs+QzCyy0XskAIQTDQgO0HYv0f5lo0o75RdOKDhNCnkXEo1Rq/SAbtjx/k/c8FOafwRcnuAFSdiv77NZ41B1bv96kO2/1/tJNxJVju80KABGD8+FNGAiqLaJlZDb5VEEifbEFGne158W49Bkga7xT9BYr3O4S/vnuYajpfT2DAc8dKzFAIaxcMIcHrGvhUY8p7HfeSXCtx+O3yXo4vENB/m+bo1ZQkCGP2pNL/911QACoH6HUmtuqjO2MgFS9no6eyJTOHvxnHDfCLSFs+FRtObQKs/aIzeCVGzMA4gX4ieak8oKwiSLSBHS3u09iYBUND54gWzvKF+YlkmQwwk+JyQl7WTLQ7g4vRTzoXEGiZ+OHzeZSVJAAYmPj9PfZty4fSDcPO+OJQsXz7Eoyv/1oh+y99jwRJ2u0XnIyZfJNs7vGjXiWgily9Sjc0p1rfZxvQbE9wnNwZ+1rjcGQmCUQ53DfcWchW8LlhgwL+YU4Wubhw4744gnQpY520rMhtbO9uOoHg30EGgkj2Vair5y0wpt52TswP8+MFB+suJA4ue+AiHAUQxi6Z2khOuhzrCmQELj3KF2wzzKLrY1YEaY0qqdBJe/0wR1flP/pSz7p9JCe9sxhZgoSciBCcFNgqFxTmHmWe/nUDEnic+N2iYqkfuD5N67RagH+zpZVzEYyh4x6Ls79QgzFo4j/bfIFS0EHGdn+umSKJOKNeNe49Eut1hwkKSUGYjgqf9Q+9rL14XzDlG7K2TnFdZm1kjVdRp5NBAG6Vdgj4Lnrcn15P/zQEDpPlhYyk9CcKWQNQwR+R+2/ZF+D03FvbRA8IK01v7ygQlthkOg7uX9mg74PLAd1zNtgbwqQdgt2aM5g1hDcNN8ER/pSWVMJ0Kho6QREs4Ea21Dvc6HrI5Bqq6FECL69S4d96/1Ga1wkt8TW0+IaMxVsW8y7rv8ilfqeZGUGARpBCERgYnEXvtcOA+ZdR3OVTb3OFPLDHi3zuFaDd0oJC3aDqaRlrD5RCfEKR6qQ1kO7YBoA8TCK4oRSRounim4Ts43ymGONuHb0RfD5YBRWBNC3VnSbvblUvmNBxr7OP82ChGOZqlt27zjf/QUPnxsTsK+SrouWgFJG9tsJey8SDOtP+esK9pg2oqQer/iwtv53r/J93PVIa/OzBnEIUCp27iAT/WiIfZh2plTTWSo5FM1AbXeEwXbS9s+z4QM8E+4UVQCe902JhifPeGneZKIjiSgdsMMQ8Ks9XeuZK3PN+Gi4QA3DWkfa6Lzc4oRTEt91xgGqe/RsQ90Vjj8BpmPYmZMCDeBc49fig8/p+9C0y59EDpnVePbfI3kNVL0B0EUlQYdf05gGxawcQ6pasDRpzzHoXPPH1OdI0zkmOP8XNx4jjL5BcwaC0GX7MScQQcWRn4OZN4EbqHxc23P2pw3aFztV67ZGq0x3QeGmIZ5X/Gy9zZwvhPB5wwSmkIq3Rdwh+P1QdiYEXFRnkBHkaZ6BDsO4eugdUQokoTY695PB1OFXArmRl+D9EO3P5QUjXAgCTgIxp3SW6UuqdAxndtiB2aiTSQekeAuhlTXQrAyL10mQdz/e2bg8Uy28IAxkMCJKXJEbuHDQ9n2eDwcFcEn9SRrmFn9yBxm66hcAtt7HUeeOxLBYhEQYk2BjFGI6CX1U40Q1D0jLE2haoSY0/4WMQjmVGeZdvJom2vsmsDQ4EBjHdpstQLA/2irMWzLGdvtgwwCJ0/Ti9Ynfo9uDivdkPb5hd3giVsM7AsQpiWi42LFU2MflpJiEiROFsWK5CDEdaedPYAEjXUSZ5uwciBxnantndsqGjIRx/kJvk6ZknnUj22jY8slmrd9+mavNGfSCBYe0tJt2EcgsZj5Zs6zyMQZZU5xLIRblNPTcQW/M7vHmMk2idtdYBBog/7Q6AGTymQVcycg3Gzijdh+WsdL/ZJ3KmwyOUw6uIabxmuurPXJ9cO81AW55Nwnfp8kII8KwNlrLqT+skyohUsocvD/uFGsepvUvug2iBSU+vV7JvLiZtvHatumzke+ClEwABHhg8AkJBZzIJ17Pks6R2zbRgPk3y/bwMml6rdlUw8N+XDJF8vhLDpOcmZaArYNLUkPr+f7O4h7wDRBOk9Wvm7MTEeIIDz9byBJ6nMjz7Sr7xfmKKavGbA6Sfu8TL9JU0ozxXw1/2uOQRAlWsDekf2Gg44veJpGv/ncggN/MIsMwoyDGl8aDt9MWm5FOp1QpoBN2q6ViexvE61A0jUMYkkkCRYn/307yP2oFuPcrYYXsa8TYdg8sHNHOPYwDdYP4CyyhmN/vceRu81OXHQy53wkoaRpcqCJkKSznWO8/xz5gqsY2MHn6Nz30PuLdUPaEa9FDp0H/40GBbf5JkZVr3wXt8PJ12qMGneMtPntj5A7yXIMILT1WTqGNKXMWkDisps1UAjzlsVTBBTeqn3hJ2n+hq4RwoNhyJhz/ggLLIYHYh8D2/YHxIuvElErqppTruzbNn8TCPWPqnQYNfBJ0vWEL5L7Uw/omo+3RbIifgiRGDRIG5RVO8fBSbYKB90HySevCWV9QiJcXQyNExZChII3aDKP92dMoLQazktQ5bfETWDdM4u5GvMoi46FfxBlGgnObXi13VlDdnvYz1FE2B8390zL6JLeSEln3ak0FXGTd6jl5HfkT+l1Rg6/lxWTzxCDzVZy1nW+BAkIHUdx5GHNUZlbuphT6IjZMCqidasJIgGzxoyF/yYmaJtfPIU3su8v7UUPCbHTIHt438s/fF+qi2x6hWZ+W/xmgbXBTJPDJl3P9PuBromynVFhZSKGZ/f+b5M9u98cc2tCd4cAEyXMo+HSchgkFfoRo84vPvkBlp70O7L6DgIjmpQzUw6bA9V5nmj8FEwjO3mNOnZlrsyDkHYkl6gdiox5PlhO2vaZ+mYWzwGphyY0Fu/kJs/3bd4B505qWu68Q9+f5vNP4WKIgWpcZ5xlqhA+hrFGwdJcAiMBicf1EemLbh39MvBU48V5Qmw2VR0QoAjxTjN8Do7p8hQeOCrpnBCO96AJuUOG6+pO7fkBFmzNikAnK1v1cjB3FHomf0TXTiRwEn9plE94j64vTHOicwNaRAJj3JzvUGDrosqJ0CAFCWkmwsI2jWK5YQaJgjwuHPV6qM2z6KTHxZDrOF3/eZwJA+JybyhJvyD2iKCwkAltEsSZnptxsRkkzKHvWJo639CbZPb/LTHCnt43xJicWM47tdfBBEgh0AQmOMpnmv3YzCKz/dze5EOkEOE4aQXTsFCJeRsFtzNdoMQjeoph0mCOyE9wzyzi/6yODObERIOI2ufg55x0ZBbq+O1G1i7lQNBpbhyatz9Hsg9Bk0eslj7C/HqrzvOpg0JSlkLyFWjG4WSiBCBFoo5qOnCTh37pCxD3JNaq36D/9UPNYda9zr+DPKIV57AC7X+i9okqWuxo7NGLe9I/b+NCuDPXCmEj/8wXSIQJmz8W7ae1F/gQPJuP9SM3a/s79bnvA3hiOuFDRGiXtpfBiF78RHlJE9WKyMZ1+oydTU3TwfE/+RXJFk4gy4wGwYklyNBGdPtjzclPTFB+LoWZhKgcz8bjybcX6tz668DbwMwZVV0MaOkJU4+DK3gtib+kIf+gxkThwT8HmHhsktWRvc+BIIFxSUhyfW3TC2AN2NyaXKNjyEz1PLIkui+tIzzOakk6ItJulYptmZOUw/DoN5mNkeuhTOgXGjKLNM/tjosWRuyj2W8IxVt0HYT6v9iMtknZbx0FXM404GswPtzzhaOvVxMAkLmV7vtOhcN0qTTAdmA/nIq50E/+TA/E1UMbhI04TXGhVOB4O3t45E4ZajVlYKc96ZTLU46gm9kQeZgXT+wRjrPpRGBaSTRugNdZ+FFrJw20xgEwOUzlEHETtXNCzqbcMdofdUmU6t/QbHeYCGd3CxLmykTIGvwRPYnJ6NtpFXNhjuF8c4zwQ7RvmjZIYEQXl/fpPcuDH9Vr3IAm9RqKERrID9TpXCAGOUH/Wdwz1bkugi/J5ofYWVGYolueCxEpicO2toqVh6ynv8uEmgMtagd8IHq18AjtQKTtJT5mOl5oib6Gg5aS8IHeetFS0+ar/P1OBZIIM8WFdVLvucMYlbjpUQDXDEQQQhJHjmQpAz/FDn12k8PsCMZylS0+jX2FH2r7PZqtBmHp0nmXCawNmIiFTH72uaRoW9rCbHG9s0MMFDcfk+8K/ReCPlOvkvR+oI7+Y1PobSLUd+r79Rqnx5D2iUz+B/R5Wtt09Xmzxox+I+In06mzxRoADZMc7ASbi2LO9uMPQBA6VcFoN/3ekubjQHO5MLGwABB0Rw90Udm4Bt9P59TY/QmhHVLB4QO+XjQjpfvs0/VRjUBb+pDJRNCCIA8mvM3L3LKgs0nfv+qb8vq92tB8uwLgpjDx+QTiJPIE1zi591rNJ0SkaQmhUbKuLvlYO5SU6naQ3EgRfIKXapKknTSRNu/G2J025+qPWgtB1DnRcC2Enl0vxf5E8G3gOLtmSoTcZhIQoe9THIpGMLANkTGXtMh3oKuICVbmB6o/TCSeULtBr7trPMH+Bf+3VpOwoZt8O5QO2CYI8gxrqBwQ65xLc07VMc4cKRDGAQER84qZ2/F5JLDfMCm3DB2T7QbMJw3fazRQFlna/gHTflX3OfNDWr5G3npqWgKorel2ClylqpuAOsYehwiAG0H3QqwyoZqqSgjQkr6JlQchs4qMcuVZDYrgrtLvPLuP71iu+RmbKW04KiRzK+0naqdoMo1vc/eQek9wMknSJloKzQ8tzLJJVr9cTHKRCGV0ex2bP5y3rrmdgOIasfnRRG2JDQFRWt9eJcmCMfIqbUREhucQDi8eg/G8pkbOd8oL5eD6eX66l/aKCdvaZSE4/F6fLAYYXrYcWlLm3ojmdRwjzNecmHfW2DKRopMIprwEngjfTofDvJrE5IzHiURZCctI7VzzvV7TRLtzYq/u5z5tv68m+mH+D8TDYJLTzbSPIafUC2JELEh8h2Tte/AsjrCR+4VvrLDj800jiQZEtjbZ1j8eCHsmoAHD1OLpsvsO+FAJXYcqeSTCO3QNj26+DTjwYDPt4CHCpB4qXxbKvsn/pNKXBEf3XPa+75D0i8gTy5hf3wud5rhW/8XnIBqENttaTVsbWAPjJC5BFu7tuK4qmIQLJQv7QxqKiBz+hYUiEcQ36HsYjJ7DH9dx7tJvpAtG5D+yMS2LIA9tM79uXs1v1jInNL/sJECoTHyq2O0NXagdJKJHzaKiJN2Be+022xLXb0dcHNM38a+VpGI9Oc6n9mMzi9WDZJdZJHVP7ya4nY7MNhCqn/PYMPYGY8JQSYyaRgOMMpO4BuqVkMB2iGXzjkKEurH/yYIPOshRxiHpX7/Y15VgB1yEm/wyJD3b5Exo7Yijr+9zLRR+DpXNV5uBU5g6RwiuA3SMs8R4r9Y1DpYBbQ84vrWuiNZr4JlLCZhUlQ285iMTmsNDPogLVo+2T4XGbjOkAymyOrj/dHqMZdqsH6FJA4lYqi/oWgmNvWWAWXkoT+qGw8DE417uVFDS4VCqiDSeZnqLCTVVznLRfuwxJ4hzLYIATv6kiXK8HccV5+2Fek/Th3folcU+sh2rr2iy6ahOjD9NbmsQoagu6kVXkD6+ObLlxwGJ7okXIy4kWSE+zAgzCRl2+QKj4Oy+bnaU8a8dYDjeo0nCJ5FfofOEcbz2fHL/0AR2ojs25XxMyvplOuFPJebg2iLbTyhVTrxMslECgP3TVtQl7dKU+CDLCScW3RQCwqNIlPC5/IHsOPa7Okfpty/o/hAwofwE2mBZM+todjUTjwLXhEbM/dnI9vPY6x/rnkXjwF7iVSPNkb+j1Ihk6QCd3GNtv9MAcdGnKgj0Pb7JEAIRpFQbxI3uJf80sAct/bQt6rB/8gyc6uGyb/swcixjrchop96JsUYLYZ4Fky1f/b+J2YRGifjpPR9rFJDUOMzuf0Upt7QLhIDjONORGeY4PzVOLCpCCHzPryFoiP1TCv8e7YPFUqy0/C3fdCQiyT+0M5n4URoPWPtKu8xNnajteMzB1LLNQwJazuHsgftwx4B5AyB0BzNYjiDhh8nDfRrF1Dnsc1ETl12j2wdhYjlce76ZNIHrs09UHea5G15TxLhmpKbdYXAHQEJuOrilpi4qByfthUIDz+u7z5MEYJKwOReOZBHSZTJCap2mzzj9HDd6bBFORSrnwPZfClFww2CsHFxPfhOsbXT88EeOFTHsNvSfBJsgXhwlRpFQcPGhE5kxX4sdSEubD9W79PkaXdeJJrhxgBHpmsJqQZKV8USpKLrkGgnBt4lk3DVsDQgtNMG0k4bSaNJ4bT9rW4GpjPZkHgH7HXT6KT7lsdLn6rjna7C2nkdQjFuzQwpgMN+1w2Hfoyft4Wyk3kst6S25nFn+or7jIfpZnJqsOEsuZVtC2FFXM7pQLhyr/rMNUaOxtkDSCI3SeepYNb0UcAMc9pWJAAF5TYkkZLtKNvwGmjZfODGva8Wxz0PXbSBpLSScQERQ0KeK6uatOZvcaHwjGiqQqZ8ayC+NAgxN1/Y5lh0gfWWatZmB0g40K4EL9/zS9u2gwFIwSrBsL7jHjspJGySYQbxIa/R8LTgc4n3LstDJkhBh0n78mRGfkeyJce7RTThAJ8kDO7PtLPnJCP+R/iNHuSlobA+2GRemXW64wUPFY9+u1/mwNvvGkcSP2rdP0tmgbc8WQe7fq6uyeSdCZXUiZSpz+7zAvoDXu8vXIUzryIr7W+G40yRiVp9xeCnXeLO+I+hxoP77dO3rCb5+13fpfz5HSWq+S9qNY+LkYu+H1jhav+83EBBIiB4BdJHBT/q0Pl+35MjWjoYrMyRs6TqTwwWozuQP08n4wUK5qzXvg0GgnQLXwTjEyKIcJF07YsHDEyM0yY0dXX05ZjhadZObtO0sRHa8vxIN5h0XwmRbR7dMlBfb7HJpP4WO0jBzcrhR/W6GTYSM5x6ygq8+1P9L+2VukJiMJIkhbC9AcvJQppz8EJe8yJxx4lJmFn4QD89hu4iyvc7f8zvfjTIvMVfwo1LEMYRZrMdfTeD8nRpgHY/MuJQU5pqi0R8BgRa9tIavzaHhdWN9tZ0Cbqrj9C71SCvSyLzSkLkf44cQ4rmEdGj/pgZ+RzhcEQenbooLl9NP8RvlAy2fZkfCal0+1SCTI30+buk/yoyAkIkiYWoF0V4Qoz5BRKsbQ82QNY2Yw4x0ShB455zm875DyUdHuLQ/P+Cms9H7oAs7n/neiUeYDjMqMY9zBjyz/eUmqFFAKoefkFfGakhS7ywNvVi40YedbCqWv+K5SuA+WQPTcROfw5n5purY2oWHDNEW9XibtsvlE20TOLgjNr5BXzXRRxPm44cyxAmYLHTKwKYm0TTt3MLhYoha0jUWDOV5gJ0Fr6PoXK9zopSF+DxhyUv0+TCfFzdmHCDqYAZqfqibmg2mmHqspXbY6b/qaBSxfLSIy+lF8LRJnXdZCZlyWhQRADhF+zhDjLC/fSHPSf0bZlJL0alHexvvQ9oqQrl7Lmgq8f8wz4gE0dbzFzr+Z3295FnajLqSsP+XljHLksDcbIP5dBS12kOv+3hYAKNxFvAJdyqiepWnJVH7giT6/bFrHFY7cFrDt6CoD+K73SbkYmGTSIICYnW3EN4j7esXWpJdKy2bmIxjuTbKGXbGUdr+lWacWXcNlPMvpswFBQ4m0Su6Mkb5C0tmT9Z72raKoZZgRjjfUn1ORBXPXYc5lxLx29GIe0AV9Pt1nutG1p49KIAmYGE+0jcPhz7YASG6tKMJjy4G4Xu8RgR7mv5HQzaZRnLiHRb2+gsxAgWU0grhfFNOf5x+EyPV9CHGz7jS23kdirQKI6pfK40Tw8SCAWVOOZI2FWtZYBCk6WKBOeyK3pU0P7YC1o4QgVvN5/iQBaYMTvhibw7bR4PstXacyf5iFkUrfx7uT5wen+KtJn6ewR5a4xKNxEgn6HV983q6tsHHQEM0RYadi+K/kv5oH0LkUcIiE5XjTo5fYNUGJshqMqkKHgIgpEtfX9rp5OFVtBAmTArRhsN+jF8d4ZqaEsE/R5ri8c0+xDDSNC4wFHMRvYrHJUx5iWyuqR1FtMO/YShfU1CwquBasc4RImZJ+KZWCx+CCFF38jHyHZ4bjECIt37KBCXtVDrj4CeixzfByUQb8LuX1sq8IhuOueXKAzGbQ8PSbjCScx5iqnEVywUFqwKYLfgUjrvLOSeHweKnqN2iEBNtsDFMrqZGC40Tzys/zc53hICP0HaEijG9WPKLnyJH3DkO6rv4/RiZcvI/9N7fTT272OoFqx9oCncspCARgq7PFjG/WgQe6zHCtHqRBh0H8UnIxL9Kr3R+J7x7vl7lzNfnNjmPY0JDyBzz/nD+nWuBafBfxGD4PKssE16wShD5AJ5qdJrscR44Q8Ro7540dXJSpk00r6YVzimS4Mu3JiJHVLd2RLwbGrNns15xsqPBAH5JymNQxo0JZcKvN+mVpGE8DiEezXySNQrmFPF+wsMO81a7ytQ6XtsR4mW9+1E6xtk77JoSnJwjCKF5ZJ6jopgFXM/3HHNNLB0e+N334hnNHgpWBF5IVd0/EWtRUu3X3b1FWTAKUpzCP29T/UBEtfxtXyBesuLukEhOosltmOCb95sbZ5wydJtbFU21YRAejkPXk/1tmrnpW7MuHWbYLIbnf/Effj/fmmSufpnGmfpemkYain5XEOuOAOFWymWoLBiYazplao6JiKX+VOl3b9NZ3+yhYEUQJS5oh8ESckrLCdMCF/rJhInanA2975cLEEcK8XpNuEyn7oG/Hsd1RAqilpawX3KBiB3ij7oqR7Hqp9l/sbabeljTmocQMA/UIUeCL0KmHDMtfBCcdsK8RLWcN+m8Vq8y36Z2WzDjv62IgABPz231nxKDoBVDED1N408Hfy8MsvJAckdZSHZjxDCYXsnUgrBc7zW5cL/fxYBoUbSZ2WCihyFI1kXLnn2tTRIwu7bgl0gD4CuQs0jFikS92qXoCZhVJCsdvaIgkb7H0kCOZO03GM51+Yp9m/BnnFSkIR/rNHSc5Sq7iELB1orOhkGAw9kDzcc1CoOsPFzxOcQglNN/U7bwM72Nq2rFIBD09gDi91r65niYbm4KIVOIkvacOdqAWRj4Ios1hdgOJiKr3O5KmMNLTh0dk/3vtdmhUaNjiwTFMmiVMLPSA4+akTGIS1bcLC/7vTDIyqPHINWX7I/kN4i+vWS0kwbZHgbBpOEhL6Ma3bFicJykJqu+lJKVcSBXAoONQ3SPGX5MXMzJCdutSQqDPEjhhgesvuOhmDi4LrVPN4ky+tP1/YV+v60MQiVsmFE8pCUeBpQP1pin1X5t7YB/wtheeM1Haz/5sQgxpy7padhRJjBR32wfZnvq5QqDPEhhDYJJUV1pe7z9mAMqjWc6NEl4YJsYBAKgRJ18xhw1VF6v0m5xdFuvvJ8gAEWEhDjj4UFyXPXf7QUFj+yrt18dIw84eBly83wUX7eYY6bm+Yuf0LmTeHylzMCnLtq8a6MwyIMUiUHcqE5OOZWq7fXtlqTbwSBeq7H3k0Vox2lMi9hu1fGSqcWir/U9QsHBjpzLvXEe7sBxtSU8EnwpBMq2/CcaX2zxvvzIAxqhddb5WAkQsLurN9fLU71YrjzXudwNHFi6iyZMgYulojDIgxQDDCJn1EwiAu096akZfN4eH4RwLuvJo+T8SmklWvZIYstpT0tCE/g8SCw8Fu4LOsdXOUm4WLCtI1Nu/5OZjvI12scEJCRtanZ49slHNS7xNQdzbF/DglEMkj/vxQxSolirD20GASweyntxMbaXQcCbkdIiNkK7c5SFjLHrkfhultY7/u0+Nl1EliLB2Zb/mMgdnUr7u0Pf/06z1SBi5eDrpDmo8j3Y57Ici6FCQ7UYpL6ixyCEv4fyJIVBVh6RpKO9/sbezQIsNIo+VHGzloNBgMsqmurcUWsqkonlZtvVpTqufCCe7ruNpg3A1MJ8in3RMf1GfR40sXKYSeQ3bVzzyGVLHBKNi0cW9BnAIe4mOEEHEjfBy3+vz/RvBSsECMSPJrA5dY0d5WTjQ5CsdkyNxJaLQQCaJF/zkcMJtalHW6JCnDydieZxeQvNpcL78bMwjnM+xNJax1hIMyDxl0Nz5PAa+szUcwmPe569WczwGb02z+BoBou8ysKsFUS3w+MW0gMg6UC4WYTTzzk4PNs8T9BNCjrRF3hnwmXwU4/dLkmOZmQfy5UV31a4QfeIh6FGEIRnVPJA0YxBCBQ0TyEuWAGEWp/Rzdiim3S13q/Td4POqKNa9axHqS7dfkST7Qs1r5/SK34WfYTXSVg9qtHmtJLdHIMO//UBzT8LdjowozCz0hglpTG5yED79+3wAwr6YJ7Rzm7KfdDDe2Ytmi6/HzH6fmFBQUFBQUFBQUFBQUFBQUFBQUFBQUFBQUFBQUFBQUFBQUFBQUFBQUFBQUFBQUFBQUFBQUFBQUFBQUFBQUFBQUFBQUFBQUFBQUFBQcF2YmLi7wAJSteLNWbtPwAAAABJRU5ErkJggg=="  alt="">
            </td>
            <td>
                <h2>DEBUG v1.6</h2>
                <h2>hati-hati</h2>
                <h2>!!</h2>
            </td>
            <td>
                <img width='100' height='80' src="data:image/png;base64,iVBORw0KGgoAAAANSUhEUgAAAMgAAACHCAYAAABTVhYnAAAABGdBTUEAALGPC/xhBQAAACBjSFJNAAB6JgAAgIQAAPoAAACA6AAAdTAAAOpgAAA6mAAAF3CculE8AAAACXBIWXMAAA7DAAAOwwHHb6hkAAAAB3RJTUUH5QQMATEqKS+dugAANXlJREFUeF7tnQm4ZVV1518PSQ9p2+50utNtd9KDdhtth44oqIg4ocU75z5mRIgBASlQGVRASgUKCkQEGQSh6t03VDGoiFFR2igaDaJGJYgiihgcoRVt2zbGGOKQ5P/7r7Pv3ffce1+9V/Wq3iPs//ft707nnmGfNa+115koKCgoKCgoKCgoKCgoKCgoKCgoKCgoKCgoKCgoKCgoKCgoKCgoKCgoKCgoKHiI4eo1/3JifvJ/TZx55j9svikoKOhhtn7GxEy9eaL7/F9vvikoKOihW58xMV3dr7FH801BQYGxqf6NiW71x2KSv52Yqc5qvi0oeAhi0zG/MnHpmn/iMb/nP/XrdKcWc/wwGKT+5MTM5H/2b+l3xjsP+kfNHgoK/h6jW+0iLXGpxtvEDNfr83vFGHdMTNd/YwbpVj/V+4/p/bv1/jq9XqNx2sRV+/27Zg8FBX+PcflB/0KMcayI/1vBEFsbMr1mJp9ZNEjBQwd/O/EPRPTPFqN8XAzwy5GMMV3/RL9vmpjf5780/yooeIhhvv6dYJI2c1S/EOO8ydqmoOAhi03Pe7iY4aYhBgmtclqzVUHBQxSb6qeIQf5Pwxg/0vuv6PXn/jxTvd/Z9YKCBxU21f984sw9/3HzKYBPsS2YqV9mhpiuvzgxW/3+xMzUo/X5jWKUH2h8e6LbeUKz5fbjqr1+bei8CwqWHTNTzxQxH2f/gPwEJSJb9v4fza+Lx3UH/jMxw7Q0xbUTc3s/vvl2YuKdB/2q9r+fo1cwzbaA/Mlc5znOp4CZvZ+s83ylzv1h/lxQsMPQrXYVUf+ZRtcEDiHjbC8VmE+zU8+bmN/nXzXfDGJaTDe3z9O3qXiR/+DDdKtbdJ5n6fVzjogVDVKwwzFXP0kE9w0RYDjUq5XwYOTp+rv986wusnYqKNghwJyaqaYiLJvnLqoPyVd4VLPV1kHCD/OMzDg+x2b5GZhps1O7SRM9d2KzCHu+s7t/w3RDw+D3LMXPgWG79dEaP8rO8//qPC8oeZWCHYNrq38tQn6JGOQyjT91achMdb/e3z0x09k4sXG//9BsOQz8jenOf238l/3sD8yJgGc7G/T+5drHmXr/ar0/TeN1en+Sxul6f4J+e5WO89KJuWpSBL67y+Fh1nFwErLeV0zxab3eo9cH5PD/f71/Z2Nu7brNQYWCgkVhtnOwzZfZzlEi+P8mX+HxE1eIgXJ8TFJ8fvLfWyt0O6/wtjP1xXa8Z+oLzRjBEMEsM1MnatsX67eTxXBHaPv1zX8u1ND3nUu1n8P1etbE/NRB0jS7TMyu+bfN0fpAQ6HRZqce6zFTf1CMcdPEln3/TbNFQcEOhgmvutxl6m1g52PGzFYHTsx11onIj9O4IDSGGALinq+e5dWDaB1MLZtce/2aB+YUWgKCxsyC+UIjHBoMJU0DE8FAZqipaiSjJMxMHSKtsa6sVCzYeUgmU26qQIBojLn6hSLeMJEg5PnO8Xo9QAT/GPsT21p0iFnF/vFVMLls7nUu0nGkxWSKzXfWmMHa2HTQw8Vkv9V8KihYAcAwhGxtKoloeZ2T7zBX7WFtsDWmgLkwyRhsuzUfIZlRXTEFPop9GZluMCZOf0HBqgFm0pzMn5n67MbXOFUS/RmW3KOACYZEZ2ktRN2VU96t3qz/b9LrjF6v0HdvNOFPY6bVT7IpN8pEglGm1/wnO/BznfP0v7X2Zbqd/fVakoIFKwyIl7Uds/W5Ygx8jYNtBrUBIc9V/12/HyUi3iIT6QsOu05Xf63PTRi2NbyAqvqp3t+n11uCiSarkQunWKWIRpmDQcQoZrzqcDny/7HZ4qEJNDHzjkk6M/Xk5tuCbQKTSUQKJ3lrMMHXTxExnqNxhJjk9SHpRag5+Bw+w0UanxWx3yrC/+aCjDFyVH+h16/q9Rs61se1rxNH5jPIzs9VLxDDvkEMs07bHTaxpf7t5tetg23HZfYfTLBm7fxPzdkZGndo3n5pAVMCFdsBIkHd6q2OUC0EE71MKAjQJpUcZBz2NrqTjzFjdOsvatygcaiY77d1jF30/t0OExN+7VZ/ooE2+YG+F/PUP9H4msbH9Pv79BsrD2e9v65MqVim+z39fqu+XzsUvuX8YN45m3uYbi9bVHIQAdGtTtVxfq/55sEHzFcvaa7P19zcrRECZrr+f3p9SbNVwaIBcXlCXUW7VhP5XRHI/s2vo9GtnmVTCeKb7bxoyKRymFbmDdqiW31E2xzsdR+AXElX5th0/Rl/j8TfvO8jxQjvsCaKvMXV+t8G/4eiw2AKFlWdZunuGi79l2SlTbDqPXr/tKGIGuFhBw0ICZN8lHZcCOzXDFl/1CHo2eqJZsoHQ/2WgyT0Fasu19x+U9eQGOP7+u5tnkO2KVgiIG6cYmeckeLOjkui15fouxcPmRsk52bqU0TMZ2m7w5xdzzEz9Qj9fpn28zXt7/SJKzJ/wXmNaqOP05XWSbmLyHNc7/9C2C6Brz6g1+dq7Ov9xDqRn2lMu0IXf4cMfiKErs5/pjpyKMMe+z5F2/+e/9NmZphqZup3fQwYM7TYz7Svb2l8Vkyy37KbJZw/RZiLMWW3BvJH3c5eOv95nfd3svm4T+fflWZ/zsjQd8ESgPnRrT/Ym1yWu87IvJnt1AMEh8NLcg7tgFk1zBxoobdrfF437VPax8mWxBCCb2R1gcbnNDbo5l2u8Qm9l5nmCBbaYH0QKeaVfBSbBdVfxvnIFJup7tTnb+tVDmd1nt7jwCMl/0rvv6Ht9Ft9ps5jMHoVtV7najRJSmmlHDb7rNX6hY3T1Y99nOXSHtZoOMsIF1/rNyzxtxUIrunOPtrXO3WuMHXDGNXXdd6X6vunLViOU7AEMJFu+dmb5LuG/BAIfJ7kHJEqmSvt6FCYRv9b40JLyLCDT9HrvLTNnF5nTPDhU/yJiT6Ox+pBNENz7BEjtr25OUdCwh/RfrRPmXCur5Jptom17Tq/8HfeaHMph0v0qeni/KYqO7E5+OzOjk3roWDOZzW/bjtgsJnqcdrXeu1T55aKPKmG1hwtFUTw8OW69Y3a358350q07y5d2xtCILUCJVwb2rt9zQWLBJOKxgiHmvUdX/JNTeAmUxoCcTkrLpMkh4sQxRz0r0oOs00XTCRJs1wyb40ZRo+fa18/1H6+r3O7U+/FFPUf6DyeOWRXY25gGlGUmP9mxx2JK2bCeW8v8PL5Sis5/CwmpH4LrdImtsXCuZ76KTpfaU2ib821UDSJz9StO0vaNwIpqpM/qv//ZbM/hMvtOufXhq80xhRkMRravPgg2wjXO9VPsoTBPOlWr9DYtfk1bGabLg7nHtB8GyBLTl6DKFVavYe2wR8IprlXIyf2pQ3MJ/wBfBKcdBjZjvfUIUPnktCdXKNtP6/fjx0gGkzCKIFZLyY5fMA2x+yieHJu8un+jO9EFcBS7XeIkASok51536/qe7qOa/U6OaTdxgGmtfCpTtTAL3yg2d8D/sz3BB7y4MQocM3TuraCZQKSLTmQvBIxiijQSQNOe5gPkl6YP1PP1qjCXIORJOkdCrZp0XRM3IYR7X8kMWVW4WB7sVa91pn4mc5r7D+MQkhb+UItMwlTEP8pfJI9e8SFcICxtxUIlunqBTrmFr3e73OPca+YhQqBZ/XmdGvgXNwOyXN7e8wB+/I8/JHeH73oBCj3yw58Z/fmm1WObuc3NVH9Clirdkvol5nIVhvQLlGJu1bEtVvzbQATijUXECwOcLdzlYkYf6NbvctEHG1D+wS/rQNNktanJ+fT5SX1C/2+DSQ5OR00Tx65gqnN8GT0pUXGlcMsFoStibQRhYtcQzrfr+n14onZyd0W7SwjmKZl7mLa4VP0BQuLvsgjvXAo57M1uNKheu/ExheMX6uz08FN4MRyaQsjYHcSz2f9QwLrrqOruezJal3z7eqAzQ5Xyr5ExPSKAZvZ+ZP63Zr8s2y6UN7RFVFExvzruk4c9rN1k+U3NESzvYOwZb5kFkHDXI4quQcRNfqM5vXUATPEpfhyyPGpaOywNRNlFLwasjrM15k7yzP1lzUX5ziHQuHlYsA8E3XCXyMK1btmwuHVdfr+SO3vefpO9ONjvtgRLDq+tCNybUx3XqT/ydycfLa3b6/ZWRG45qi+ZGCNgkOp1W2+8NnOm3o3BdVrCVH9UhM8bCfCbNQYjSOCHQkTWOesIKbMaQeEegmF2v9wxOpVep9s5B00NH/MIyUUSH78C0w/Mt9tIud3fBQcdkeP5MQmsO0cxDZ15MScxlL8DAoju9Ux2vfH9Jo5yw5fr7NptJS8CSYi/kq/NxjjOzrvOdEJxK3rk2Pu3308ghwaNrfwzS5Y8IFD0JRD5t7/3TrWc5tfVhCRRT5jYKJYy00JBRNAOXj6DTs42v7/TN8f4e8AkpKmag5LOoT3suaX5UVOWG0ic3LNq/+O1bn07eeQnjfp+0/qWr+k6yJzy9LWdIOXf7h2q7qlOZ/ne17Cv+HYt/Zscl5Dym7W7/PePsLCZw3cD4ROMD9h44XDrcwLznBX2gqTsl9HJmfZj2o43s70tmCmc3yzLw0nJy/Xue0ec2zGWbhmzTmgBUpIMCdjG7a/d6vXusNhdUkSrBVhCU5Osf+32BEDdC0PBnnASSzboSkKUt/X/OcOq1iAPRthWZobbHulqrPavrFPNeG4GYMYFI0F8JWckOtcOjGvbXJEmcftksC/q21wJAdv2o4ZhDTP9flyntZeMkHcfqj+A/12aHMub9fny3RtVc+/YPtu9akBIg6zplneq3lvCwfAPYr8zut1/z7fv3+W3pTQHKX/PqLZetswUx2ifZI4JIm6S8+MpY/XoLO/wJCvle4b18y9S4j7eJ7m4Fq9HrZof2iHwSpT0pUbmYOkWXK6YKDEIEiLyIQijS7Wb3PaDrtdGkUTh+mC2mbibPdXb9L4lrb5c/3vJh2v348KKU9J89bCiPwOk4a6ng0p6zKFu3umiNd7kw8gItWEbwGE1a2u8k2J7Pi8r4vchNdwVHf2rnO5h7P7kuTTOj5+Duc+U/+h3n9C470aJ5pp20RgrYJJ1JK0RNli+e6xA+Ywcx3O7Xk61ley6/mRvnu/xiGa6+UxeQkmcH6JwBMIVYcJq+M6uSgh6gLNpA3yeYm2S0TSbHEQMJApmACt5b7bigJnK0oeLtMNeLlrbuL7PoOY43MTq1cqgJSUHc/aBwoH5cBvmny63l8cnxt7cnByzu5JP8J/dpCrg/yZGw1xtx05fo/ycf6P2o0eV74hujHsz+u8bf+u7TEzgIFchNhZo//tqvf3+pxwBkGEJymOy9oCLdNwToQEHgKCLiXOKxxuST4/dYiPPw7kcfCX8rlw9LDzWjnqcqqbyoEoEZfwaObEw5rqHRpTA4GXHYnZem8dV/fIguAM0wlahRq29CSu/vmtNz0Rho+HD0Fnb1mdNVg43c6W6sRRyUgof4/92iszuNJhtygZ+LC380XBGHI4Xd3KszMoNqu/698xL2aqc+L/+ZA0RTogicLUgOivtzbhpjvzKmLOwXEhNhOciwe/1OwrQqLsLwr8ThKjDIaeOT/3wRKjmEB9Hjjnr9MxaUR9oL6/XK/jbGeZZvYPpGmSybKUoTl0kaI0adJsjkqJSTbtMj4zjaa2FpHvkQCz0PSBKF1azx61ZOl4jbM89bwFcyQIlNy/WQ5EoeYHzRi5+RcmWb/XF7Tm/EvnCfrc9wP9fWef5l+rCJH5ZGEQJ0pFaySqUpNmnzz2bH2zfqPYDo1BBOuvdJOP88UigYmpm8jImMpXILOLdDMTOJoRE0H9DbC5U98Y+8d2xXSTmdd1acOVPdsWhANIb6tTmnDtWm+TIlVcg9vrIHWz6E/4KpSjvFvjLT7ndB7hE4QJMED4XJttaSIvCIg32k52wq+6Tb99W99lzd0WGAgRCBYfLCcaQpfM3UKmpX0umWE8CzGBfcyxNBfTdurIqAqgDARnWfPDHLa1bxuOljVNKZYT+DZ5O1cEHibiQBhYA1pxMjCrI+v/9trm36sIVnWTu+lGHOXXvimFagwG8XDJN0tPT9SFfVefIR5qdn7UEN5H9duRnqgckRk9Xb/TDO0HPefdvkEm/dAMSKEourtrYvOaR3q7BLZPRAbz5AxkM8m27LEikr7D52yxy0fQGIusqfJ1yVdwcSFd3MX4YvJptKMcbGtRR/2+E+dKlMhPlmIb6qLYD/N2gwhR2k4M62uVj5Tsaj5TfrJQ4zrMxLimk5tvAgQg0CCUnlwrRmP/5DDy+RgH1quwLCAE2S0LHn97EPfjCs1L5Fv6c/vHthLCF5RWz35DYK1KDdIGE475EesZ0gUQGny2HU4zSM8kwym7Ud+NdwIt3cUIIS229OxMCCB8lTRB94ugZJKJEYPhRmec22A/lLlbg0ydOGDH4ky6fKN3HYsdd+t6K72iefrfwxD4bMBLQ91g+mS9XhmazeYc2pJixVN65+IQrRzTlCH3tet8ydsshG51nPZ18UACj33NSqvRFWUpBI7gwx9IWpR7h9+2nIigzDE6RmvObXm8vec3ISCikXi2jQQslsKqBSUaXrNgrYDkZBlpqEAkqAsCySNYGjPBrHk4Z6yZABGw+MWmmfdxqyVdDogoJHaaJKRyYwZlocBxgCnJF5B3gVGRynn0wyYeyane/pcwKHcn8QXDpjUhnTnNUzQSCMb/sIj1Rr2PCCDayz6U/u81Is33SHqSaJt1Pgl8bs9HG/FIhXkTVELkTQhnHzFgTm4NmGMRGUvX9z37C1sD9xFGxxLgNTcVE9DUnKuLPZs1L3EMVk/eoms9aigjHiX1FDRiPUgzV5PNL6sQ5mg5ouF4ozmQjuv12jCDifZneqUM/Aa9Etb9uS98FKK+aZ22obsHTuoHRbxPaX7tAwLsMURrkLcYV9gHQgMRtcpMJxKU1WG9MmmkfZiGg/tezAgf5QLtj964kayal92OL5LgKl37XP2wMlEmm1g+boRpOVcWQVGHlZgeX6JdKwYgQEwQM4J8uRQIcfia+rfJ1+iVhOdtGq/WHNZm2ghWjF8/QSjZtV6+Ps7vTb15agNGIAIVKyWv1PayEsxc8hmZE5nCOdO6TL63dgQfFYGFOX7IgjVVEYi4THO9R4/xYOTFmIs7FUjdKBk/VRf1OEs2S9DGeY11wiQTRXBS8ekZ4YSFc4Rj1tF/P6JXbgKlBaePNQVIOobPgdNP04PMZpX0gdgxn9AEbZBPiRvRJ2pGhFMvNXNhFiZzMH673yPffqHh3E39Zb0Pcw8Cz9eWRH6mM9CFxD2uMF8IDmiumFuvvSbIQO6j+f/MFF3nw1wLCfxEfX6x/vtm7ZPgBXMcgiiECK9/49E7P92f0PT4hARaLnaYfZzmhdG9Hl5MNsokRks4qkeTiV7Sd9S8QA/n9bQCzBfry4/U/j+k/588wEALIT9XJ6F1fovRbDsdXFCsYqMk4usDNwJpkKQNdqLzCvo+OZDWQFNk2FlnQYII6TltKbQQMOtiuSpLZrHlYdK/8LFDW8lHaTLAbYQvxA2EcCDkjHB4z7PKbTJyPlESsWmfp1vitiMrCw0c82QKtRkEYHcn2xoQag5JerNzSkTPQuITZWPNxS6eL5egYCrpOmAIomPjQ81LGffq+l9uxmwDPwSmToGYBDSPiwNFnOFXjtrv4AhHf92A1oq1Np/0tfjaxPiLhQVvMrlkzYzTbisGbhgFYkF0n9cFvl+vyd/Y2OP0sPvjQqKbIHVGMs+QzCyy0XskAIQTDQgO0HYv0f5lo0o75RdOKDhNCnkXEo1Rq/SAbtjx/k/c8FOafwRcnuAFSdiv77NZ41B1bv96kO2/1/tJNxJVju80KABGD8+FNGAiqLaJlZDb5VEEifbEFGne158W49Bkga7xT9BYr3O4S/vnuYajpfT2DAc8dKzFAIaxcMIcHrGvhUY8p7HfeSXCtx+O3yXo4vENB/m+bo1ZQkCGP2pNL/911QACoH6HUmtuqjO2MgFS9no6eyJTOHvxnHDfCLSFs+FRtObQKs/aIzeCVGzMA4gX4ieak8oKwiSLSBHS3u09iYBUND54gWzvKF+YlkmQwwk+JyQl7WTLQ7g4vRTzoXEGiZ+OHzeZSVJAAYmPj9PfZty4fSDcPO+OJQsXz7Eoyv/1oh+y99jwRJ2u0XnIyZfJNs7vGjXiWgily9Sjc0p1rfZxvQbE9wnNwZ+1rjcGQmCUQ53DfcWchW8LlhgwL+YU4Wubhw4744gnQpY520rMhtbO9uOoHg30EGgkj2Vair5y0wpt52TswP8+MFB+suJA4ue+AiHAUQxi6Z2khOuhzrCmQELj3KF2wzzKLrY1YEaY0qqdBJe/0wR1flP/pSz7p9JCe9sxhZgoSciBCcFNgqFxTmHmWe/nUDEnic+N2iYqkfuD5N67RagH+zpZVzEYyh4x6Ls79QgzFo4j/bfIFS0EHGdn+umSKJOKNeNe49Eut1hwkKSUGYjgqf9Q+9rL14XzDlG7K2TnFdZm1kjVdRp5NBAG6Vdgj4Lnrcn15P/zQEDpPlhYyk9CcKWQNQwR+R+2/ZF+D03FvbRA8IK01v7ygQlthkOg7uX9mg74PLAd1zNtgbwqQdgt2aM5g1hDcNN8ER/pSWVMJ0Kho6QREs4Ea21Dvc6HrI5Bqq6FECL69S4d96/1Ga1wkt8TW0+IaMxVsW8y7rv8ilfqeZGUGARpBCERgYnEXvtcOA+ZdR3OVTb3OFPLDHi3zuFaDd0oJC3aDqaRlrD5RCfEKR6qQ1kO7YBoA8TCK4oRSRounim4Ts43ymGONuHb0RfD5YBRWBNC3VnSbvblUvmNBxr7OP82ChGOZqlt27zjf/QUPnxsTsK+SrouWgFJG9tsJey8SDOtP+esK9pg2oqQer/iwtv53r/J93PVIa/OzBnEIUCp27iAT/WiIfZh2plTTWSo5FM1AbXeEwXbS9s+z4QM8E+4UVQCe902JhifPeGneZKIjiSgdsMMQ8Ks9XeuZK3PN+Gi4QA3DWkfa6Lzc4oRTEt91xgGqe/RsQ90Vjj8BpmPYmZMCDeBc49fig8/p+9C0y59EDpnVePbfI3kNVL0B0EUlQYdf05gGxawcQ6pasDRpzzHoXPPH1OdI0zkmOP8XNx4jjL5BcwaC0GX7MScQQcWRn4OZN4EbqHxc23P2pw3aFztV67ZGq0x3QeGmIZ5X/Gy9zZwvhPB5wwSmkIq3Rdwh+P1QdiYEXFRnkBHkaZ6BDsO4eugdUQokoTY695PB1OFXArmRl+D9EO3P5QUjXAgCTgIxp3SW6UuqdAxndtiB2aiTSQekeAuhlTXQrAyL10mQdz/e2bg8Uy28IAxkMCJKXJEbuHDQ9n2eDwcFcEn9SRrmFn9yBxm66hcAtt7HUeeOxLBYhEQYk2BjFGI6CX1U40Q1D0jLE2haoSY0/4WMQjmVGeZdvJom2vsmsDQ4EBjHdpstQLA/2irMWzLGdvtgwwCJ0/Ti9Ynfo9uDivdkPb5hd3giVsM7AsQpiWi42LFU2MflpJiEiROFsWK5CDEdaedPYAEjXUSZ5uwciBxnantndsqGjIRx/kJvk6ZknnUj22jY8slmrd9+mavNGfSCBYe0tJt2EcgsZj5Zs6zyMQZZU5xLIRblNPTcQW/M7vHmMk2idtdYBBog/7Q6AGTymQVcycg3Gzijdh+WsdL/ZJ3KmwyOUw6uIabxmuurPXJ9cO81AW55Nwnfp8kII8KwNlrLqT+skyohUsocvD/uFGsepvUvug2iBSU+vV7JvLiZtvHatumzke+ClEwABHhg8AkJBZzIJ17Pks6R2zbRgPk3y/bwMml6rdlUw8N+XDJF8vhLDpOcmZaArYNLUkPr+f7O4h7wDRBOk9Wvm7MTEeIIDz9byBJ6nMjz7Sr7xfmKKavGbA6Sfu8TL9JU0ozxXw1/2uOQRAlWsDekf2Gg44veJpGv/ncggN/MIsMwoyDGl8aDt9MWm5FOp1QpoBN2q6ViexvE61A0jUMYkkkCRYn/307yP2oFuPcrYYXsa8TYdg8sHNHOPYwDdYP4CyyhmN/vceRu81OXHQy53wkoaRpcqCJkKSznWO8/xz5gqsY2MHn6Nz30PuLdUPaEa9FDp0H/40GBbf5JkZVr3wXt8PJ12qMGneMtPntj5A7yXIMILT1WTqGNKXMWkDisps1UAjzlsVTBBTeqn3hJ2n+hq4RwoNhyJhz/ggLLIYHYh8D2/YHxIuvElErqppTruzbNn8TCPWPqnQYNfBJ0vWEL5L7Uw/omo+3RbIifgiRGDRIG5RVO8fBSbYKB90HySevCWV9QiJcXQyNExZChII3aDKP92dMoLQazktQ5bfETWDdM4u5GvMoi46FfxBlGgnObXi13VlDdnvYz1FE2B8390zL6JLeSEln3ak0FXGTd6jl5HfkT+l1Rg6/lxWTzxCDzVZy1nW+BAkIHUdx5GHNUZlbuphT6IjZMCqidasJIgGzxoyF/yYmaJtfPIU3su8v7UUPCbHTIHt438s/fF+qi2x6hWZ+W/xmgbXBTJPDJl3P9PuBromynVFhZSKGZ/f+b5M9u98cc2tCd4cAEyXMo+HSchgkFfoRo84vPvkBlp70O7L6DgIjmpQzUw6bA9V5nmj8FEwjO3mNOnZlrsyDkHYkl6gdiox5PlhO2vaZ+mYWzwGphyY0Fu/kJs/3bd4B505qWu68Q9+f5vNP4WKIgWpcZ5xlqhA+hrFGwdJcAiMBicf1EemLbh39MvBU48V5Qmw2VR0QoAjxTjN8Do7p8hQeOCrpnBCO96AJuUOG6+pO7fkBFmzNikAnK1v1cjB3FHomf0TXTiRwEn9plE94j64vTHOicwNaRAJj3JzvUGDrosqJ0CAFCWkmwsI2jWK5YQaJgjwuHPV6qM2z6KTHxZDrOF3/eZwJA+JybyhJvyD2iKCwkAltEsSZnptxsRkkzKHvWJo639CbZPb/LTHCnt43xJicWM47tdfBBEgh0AQmOMpnmv3YzCKz/dze5EOkEOE4aQXTsFCJeRsFtzNdoMQjeoph0mCOyE9wzyzi/6yODObERIOI2ufg55x0ZBbq+O1G1i7lQNBpbhyatz9Hsg9Bk0eslj7C/HqrzvOpg0JSlkLyFWjG4WSiBCBFoo5qOnCTh37pCxD3JNaq36D/9UPNYda9zr+DPKIV57AC7X+i9okqWuxo7NGLe9I/b+NCuDPXCmEj/8wXSIQJmz8W7ae1F/gQPJuP9SM3a/s79bnvA3hiOuFDRGiXtpfBiF78RHlJE9WKyMZ1+oydTU3TwfE/+RXJFk4gy4wGwYklyNBGdPtjzclPTFB+LoWZhKgcz8bjybcX6tz668DbwMwZVV0MaOkJU4+DK3gtib+kIf+gxkThwT8HmHhsktWRvc+BIIFxSUhyfW3TC2AN2NyaXKNjyEz1PLIkui+tIzzOakk6ItJulYptmZOUw/DoN5mNkeuhTOgXGjKLNM/tjosWRuyj2W8IxVt0HYT6v9iMtknZbx0FXM404GswPtzzhaOvVxMAkLmV7vtOhcN0qTTAdmA/nIq50E/+TA/E1UMbhI04TXGhVOB4O3t45E4ZajVlYKc96ZTLU46gm9kQeZgXT+wRjrPpRGBaSTRugNdZ+FFrJw20xgEwOUzlEHETtXNCzqbcMdofdUmU6t/QbHeYCGd3CxLmykTIGvwRPYnJ6NtpFXNhjuF8c4zwQ7RvmjZIYEQXl/fpPcuDH9Vr3IAm9RqKERrID9TpXCAGOUH/Wdwz1bkugi/J5ofYWVGYolueCxEpicO2toqVh6ynv8uEmgMtagd8IHq18AjtQKTtJT5mOl5oib6Gg5aS8IHeetFS0+ar/P1OBZIIM8WFdVLvucMYlbjpUQDXDEQQQhJHjmQpAz/FDn12k8PsCMZylS0+jX2FH2r7PZqtBmHp0nmXCawNmIiFTH72uaRoW9rCbHG9s0MMFDcfk+8K/ReCPlOvkvR+oI7+Y1PobSLUd+r79Rqnx5D2iUz+B/R5Wtt09Xmzxox+I+In06mzxRoADZMc7ASbi2LO9uMPQBA6VcFoN/3ekubjQHO5MLGwABB0Rw90Udm4Bt9P59TY/QmhHVLB4QO+XjQjpfvs0/VRjUBb+pDJRNCCIA8mvM3L3LKgs0nfv+qb8vq92tB8uwLgpjDx+QTiJPIE1zi591rNJ0SkaQmhUbKuLvlYO5SU6naQ3EgRfIKXapKknTSRNu/G2J025+qPWgtB1DnRcC2Enl0vxf5E8G3gOLtmSoTcZhIQoe9THIpGMLANkTGXtMh3oKuICVbmB6o/TCSeULtBr7trPMH+Bf+3VpOwoZt8O5QO2CYI8gxrqBwQ65xLc07VMc4cKRDGAQER84qZ2/F5JLDfMCm3DB2T7QbMJw3fazRQFlna/gHTflX3OfNDWr5G3npqWgKorel2ClylqpuAOsYehwiAG0H3QqwyoZqqSgjQkr6JlQchs4qMcuVZDYrgrtLvPLuP71iu+RmbKW04KiRzK+0naqdoMo1vc/eQek9wMknSJloKzQ8tzLJJVr9cTHKRCGV0ex2bP5y3rrmdgOIasfnRRG2JDQFRWt9eJcmCMfIqbUREhucQDi8eg/G8pkbOd8oL5eD6eX66l/aKCdvaZSE4/F6fLAYYXrYcWlLm3ojmdRwjzNecmHfW2DKRopMIprwEngjfTofDvJrE5IzHiURZCctI7VzzvV7TRLtzYq/u5z5tv68m+mH+D8TDYJLTzbSPIafUC2JELEh8h2Tte/AsjrCR+4VvrLDj800jiQZEtjbZ1j8eCHsmoAHD1OLpsvsO+FAJXYcqeSTCO3QNj26+DTjwYDPt4CHCpB4qXxbKvsn/pNKXBEf3XPa+75D0i8gTy5hf3wud5rhW/8XnIBqENttaTVsbWAPjJC5BFu7tuK4qmIQLJQv7QxqKiBz+hYUiEcQ36HsYjJ7DH9dx7tJvpAtG5D+yMS2LIA9tM79uXs1v1jInNL/sJECoTHyq2O0NXagdJKJHzaKiJN2Be+022xLXb0dcHNM38a+VpGI9Oc6n9mMzi9WDZJdZJHVP7ya4nY7MNhCqn/PYMPYGY8JQSYyaRgOMMpO4BuqVkMB2iGXzjkKEurH/yYIPOshRxiHpX7/Y15VgB1yEm/wyJD3b5Exo7Yijr+9zLRR+DpXNV5uBU5g6RwiuA3SMs8R4r9Y1DpYBbQ84vrWuiNZr4JlLCZhUlQ285iMTmsNDPogLVo+2T4XGbjOkAymyOrj/dHqMZdqsH6FJA4lYqi/oWgmNvWWAWXkoT+qGw8DE417uVFDS4VCqiDSeZnqLCTVVznLRfuwxJ4hzLYIATv6kiXK8HccV5+2Fek/Th3folcU+sh2rr2iy6ahOjD9NbmsQoagu6kVXkD6+ObLlxwGJ7okXIy4kWSE+zAgzCRl2+QKj4Oy+bnaU8a8dYDjeo0nCJ5FfofOEcbz2fHL/0AR2ojs25XxMyvplOuFPJebg2iLbTyhVTrxMslECgP3TVtQl7dKU+CDLCScW3RQCwqNIlPC5/IHsOPa7Okfpty/o/hAwofwE2mBZM+todjUTjwLXhEbM/dnI9vPY6x/rnkXjwF7iVSPNkb+j1Ihk6QCd3GNtv9MAcdGnKgj0Pb7JEAIRpFQbxI3uJf80sAct/bQt6rB/8gyc6uGyb/swcixjrchop96JsUYLYZ4Fky1f/b+J2YRGifjpPR9rFJDUOMzuf0Upt7QLhIDjONORGeY4PzVOLCpCCHzPryFoiP1TCv8e7YPFUqy0/C3fdCQiyT+0M5n4URoPWPtKu8xNnajteMzB1LLNQwJazuHsgftwx4B5AyB0BzNYjiDhh8nDfRrF1Dnsc1ETl12j2wdhYjlce76ZNIHrs09UHea5G15TxLhmpKbdYXAHQEJuOrilpi4qByfthUIDz+u7z5MEYJKwOReOZBHSZTJCap2mzzj9HDd6bBFORSrnwPZfClFww2CsHFxPfhOsbXT88EeOFTHsNvSfBJsgXhwlRpFQcPGhE5kxX4sdSEubD9W79PkaXdeJJrhxgBHpmsJqQZKV8USpKLrkGgnBt4lk3DVsDQgtNMG0k4bSaNJ4bT9rW4GpjPZkHgH7HXT6KT7lsdLn6rjna7C2nkdQjFuzQwpgMN+1w2Hfoyft4Wyk3kst6S25nFn+or7jIfpZnJqsOEsuZVtC2FFXM7pQLhyr/rMNUaOxtkDSCI3SeepYNb0UcAMc9pWJAAF5TYkkZLtKNvwGmjZfODGva8Wxz0PXbSBpLSScQERQ0KeK6uatOZvcaHwjGiqQqZ8ayC+NAgxN1/Y5lh0gfWWatZmB0g40K4EL9/zS9u2gwFIwSrBsL7jHjspJGySYQbxIa/R8LTgc4n3LstDJkhBh0n78mRGfkeyJce7RTThAJ8kDO7PtLPnJCP+R/iNHuSlobA+2GRemXW64wUPFY9+u1/mwNvvGkcSP2rdP0tmgbc8WQe7fq6uyeSdCZXUiZSpz+7zAvoDXu8vXIUzryIr7W+G40yRiVp9xeCnXeLO+I+hxoP77dO3rCb5+13fpfz5HSWq+S9qNY+LkYu+H1jhav+83EBBIiB4BdJHBT/q0Pl+35MjWjoYrMyRs6TqTwwWozuQP08n4wUK5qzXvg0GgnQLXwTjEyKIcJF07YsHDEyM0yY0dXX05ZjhadZObtO0sRHa8vxIN5h0XwmRbR7dMlBfb7HJpP4WO0jBzcrhR/W6GTYSM5x6ygq8+1P9L+2VukJiMJIkhbC9AcvJQppz8EJe8yJxx4lJmFn4QD89hu4iyvc7f8zvfjTIvMVfwo1LEMYRZrMdfTeD8nRpgHY/MuJQU5pqi0R8BgRa9tIavzaHhdWN9tZ0Cbqrj9C71SCvSyLzSkLkf44cQ4rmEdGj/pgZ+RzhcEQenbooLl9NP8RvlAy2fZkfCal0+1SCTI30+buk/yoyAkIkiYWoF0V4Qoz5BRKsbQ82QNY2Yw4x0ShB455zm875DyUdHuLQ/P+Cms9H7oAs7n/neiUeYDjMqMY9zBjyz/eUmqFFAKoefkFfGakhS7ywNvVi40YedbCqWv+K5SuA+WQPTcROfw5n5purY2oWHDNEW9XibtsvlE20TOLgjNr5BXzXRRxPm44cyxAmYLHTKwKYm0TTt3MLhYoha0jUWDOV5gJ0Fr6PoXK9zopSF+DxhyUv0+TCfFzdmHCDqYAZqfqibmg2mmHqspXbY6b/qaBSxfLSIy+lF8LRJnXdZCZlyWhQRADhF+zhDjLC/fSHPSf0bZlJL0alHexvvQ9oqQrl7Lmgq8f8wz4gE0dbzFzr+Z3295FnajLqSsP+XljHLksDcbIP5dBS12kOv+3hYAKNxFvAJdyqiepWnJVH7giT6/bFrHFY7cFrDt6CoD+K73SbkYmGTSIICYnW3EN4j7esXWpJdKy2bmIxjuTbKGXbGUdr+lWacWXcNlPMvpswFBQ4m0Su6Mkb5C0tmT9Z72raKoZZgRjjfUn1ORBXPXYc5lxLx29GIe0AV9Pt1nutG1p49KIAmYGE+0jcPhz7YASG6tKMJjy4G4Xu8RgR7mv5HQzaZRnLiHRb2+gsxAgWU0grhfFNOf5x+EyPV9CHGz7jS23kdirQKI6pfK40Tw8SCAWVOOZI2FWtZYBCk6WKBOeyK3pU0P7YC1o4QgVvN5/iQBaYMTvhibw7bR4PstXacyf5iFkUrfx7uT5wen+KtJn6ewR5a4xKNxEgn6HV983q6tsHHQEM0RYadi+K/kv5oH0LkUcIiE5XjTo5fYNUGJshqMqkKHgIgpEtfX9rp5OFVtBAmTArRhsN+jF8d4ZqaEsE/R5ri8c0+xDDSNC4wFHMRvYrHJUx5iWyuqR1FtMO/YShfU1CwquBasc4RImZJ+KZWCx+CCFF38jHyHZ4bjECIt37KBCXtVDrj4CeixzfByUQb8LuX1sq8IhuOueXKAzGbQ8PSbjCScx5iqnEVywUFqwKYLfgUjrvLOSeHweKnqN2iEBNtsDFMrqZGC40Tzys/zc53hICP0HaEijG9WPKLnyJH3DkO6rv4/RiZcvI/9N7fTT272OoFqx9oCncspCARgq7PFjG/WgQe6zHCtHqRBh0H8UnIxL9Kr3R+J7x7vl7lzNfnNjmPY0JDyBzz/nD+nWuBafBfxGD4PKssE16wShD5AJ5qdJrscR44Q8Ro7540dXJSpk00r6YVzimS4Mu3JiJHVLd2RLwbGrNns15xsqPBAH5JymNQxo0JZcKvN+mVpGE8DiEezXySNQrmFPF+wsMO81a7ytQ6XtsR4mW9+1E6xtk77JoSnJwjCKF5ZJ6jopgFXM/3HHNNLB0e+N334hnNHgpWBF5IVd0/EWtRUu3X3b1FWTAKUpzCP29T/UBEtfxtXyBesuLukEhOosltmOCb95sbZ5wydJtbFU21YRAejkPXk/1tmrnpW7MuHWbYLIbnf/Effj/fmmSufpnGmfpemkYain5XEOuOAOFWymWoLBiYazplao6JiKX+VOl3b9NZ3+yhYEUQJS5oh8ESckrLCdMCF/rJhInanA2975cLEEcK8XpNuEyn7oG/Hsd1RAqilpawX3KBiB3ij7oqR7Hqp9l/sbabeljTmocQMA/UIUeCL0KmHDMtfBCcdsK8RLWcN+m8Vq8y36Z2WzDjv62IgABPz231nxKDoBVDED1N408Hfy8MsvJAckdZSHZjxDCYXsnUgrBc7zW5cL/fxYBoUbSZ2WCihyFI1kXLnn2tTRIwu7bgl0gD4CuQs0jFikS92qXoCZhVJCsdvaIgkb7H0kCOZO03GM51+Yp9m/BnnFSkIR/rNHSc5Sq7iELB1orOhkGAw9kDzcc1CoOsPFzxOcQglNN/U7bwM72Nq2rFIBD09gDi91r65niYbm4KIVOIkvacOdqAWRj4Ios1hdgOJiKr3O5KmMNLTh0dk/3vtdmhUaNjiwTFMmiVMLPSA4+akTGIS1bcLC/7vTDIyqPHINWX7I/kN4i+vWS0kwbZHgbBpOEhL6Ma3bFicJykJqu+lJKVcSBXAoONQ3SPGX5MXMzJCdutSQqDPEjhhgesvuOhmDi4LrVPN4ky+tP1/YV+v60MQiVsmFE8pCUeBpQP1pin1X5t7YB/wtheeM1Haz/5sQgxpy7padhRJjBR32wfZnvq5QqDPEhhDYJJUV1pe7z9mAMqjWc6NEl4YJsYBAKgRJ18xhw1VF6v0m5xdFuvvJ8gAEWEhDjj4UFyXPXf7QUFj+yrt18dIw84eBly83wUX7eYY6bm+Yuf0LmTeHylzMCnLtq8a6MwyIMUiUHcqE5OOZWq7fXtlqTbwSBeq7H3k0Vox2lMi9hu1fGSqcWir/U9QsHBjpzLvXEe7sBxtSU8EnwpBMq2/CcaX2zxvvzIAxqhddb5WAkQsLurN9fLU71YrjzXudwNHFi6iyZMgYulojDIgxQDDCJn1EwiAu096akZfN4eH4RwLuvJo+T8SmklWvZIYstpT0tCE/g8SCw8Fu4LOsdXOUm4WLCtI1Nu/5OZjvI12scEJCRtanZ49slHNS7xNQdzbF/DglEMkj/vxQxSolirD20GASweyntxMbaXQcCbkdIiNkK7c5SFjLHrkfhultY7/u0+Nl1EliLB2Zb/mMgdnUr7u0Pf/06z1SBi5eDrpDmo8j3Y57Ici6FCQ7UYpL6ixyCEv4fyJIVBVh6RpKO9/sbezQIsNIo+VHGzloNBgMsqmurcUWsqkonlZtvVpTqufCCe7ruNpg3A1MJ8in3RMf1GfR40sXKYSeQ3bVzzyGVLHBKNi0cW9BnAIe4mOEEHEjfBy3+vz/RvBSsECMSPJrA5dY0d5WTjQ5CsdkyNxJaLQQCaJF/zkcMJtalHW6JCnDydieZxeQvNpcL78bMwjnM+xNJax1hIMyDxl0Nz5PAa+szUcwmPe569WczwGb02z+BoBou8ysKsFUS3w+MW0gMg6UC4WYTTzzk4PNs8T9BNCjrRF3hnwmXwU4/dLkmOZmQfy5UV31a4QfeIh6FGEIRnVPJA0YxBCBQ0TyEuWAGEWp/Rzdiim3S13q/Td4POqKNa9axHqS7dfkST7Qs1r5/SK34WfYTXSVg9qtHmtJLdHIMO//UBzT8LdjowozCz0hglpTG5yED79+3wAwr6YJ7Rzm7KfdDDe2Ytmi6/HzH6fmFBQUFBQUFBQUFBQUFBQUFBQUFBQUFBQUFBQUFBQUFBQUFBQUFBQUFBQUFBQUFBQUFBQUFBQUFBQUFBQUFBQUFBQUFBQUFBQUFBQcF2YmLi7wAJSteLNWbtPwAAAABJRU5ErkJggg=="  alt="">
            </td>
        </tr>
    </table>
<h2>Setting Admin</h2>
<h3>Iqomah</h3>
<div class='info'>
    <p>debug</p>
    <span>Tombol&nbsp</span><span id='showtombol'></span>
    <span>&nbsp&nbspDetik&nbsp</span><span id='detik'></span><br><br>
</div>

<form>

    <table width='100%'>
        <tr>
            <td>
            <label for="latitude">Latitude</label><br>
            <input id="latitude" placeholder="-6.230900" size="9"/>
            </td>
            <td>
            <label for="longitude">Longitude</label><br>
            <input id="longitude" placeholder="106.778941" size="9"/>
            </td>    
        </tr>
        <tr>
            <td>
            <label for="zonawaktu">Zona Waktu</label><br>
            <input id="zonawaktu" placeholder="7" size="3"/>
            </td>
            <td>
            <label for="hilal">Hilal</label><br>
            <input id="hilal" placeholder="2" maxlength="2" size="3"/>
            </td>
        </tr>
        <tr>
            <td>
            <label for="ssid">SSID</label><br>
            <input id="ssid" placeholder="JWS Al-Furqon" type="text"/>
            </td>
            <td>
            <label for="password">Password</label><br>
            <input id="password" placeholder="alfurqon" type="text"/>
            </td>
        </tr>
        <tr>
            <td colspan="3">
            <label for="batastombol">Batas Tombol</label><br>
            <input id="batastombol" placeholder="300" maxlength="3"/>
            </td>
        </tr>
    </table>
    <br>
    <div>
    <button onClick="setJws()"> Simpan </button>
    </div>
</form>

<form>
        <h4>Update</h4>  
        <input  name='en'><br><br>
        <input type='submit' value='Ubah Tanggal'> 
      </form>
</body>

<script>

    var xmlHttp=createXmlHttpObject();
    //var xmlHttp=createXmlHttpObject();

    function createXmlHttpObject(){
    if(window.XMLHttpRequest){
        xmlHttp=new XMLHttpRequest();
    }else{
        xmlHttp=new ActiveXObject('Microsoft.XMLHTTP');// code for IE6, IE5
    }
    return xmlHttp;
    }
    function updateData() {
        prosesdataadmin();
        debug();
    }

    function prosesdataadmin(){
        if(xmlHttp.readyState==0 || xmlHttp.readyState==4){
            xmlHttp.open('PUT','xmldataadmin',true);
            xmlHttp.onreadystatechange=handleServerResponseDataAdmin;
            xmlHttp.send(null);
        }
    }

    function debug(){
    if(xmlHttp.readyState==0 || xmlHttp.readyState==4){
        xmlHttp.open('POST','xmldebug',true);
        xmlHttp.onreadystatechange=handleServerResponseDebug;
        xmlHttp.send(null);
    }
    setTimeout('debug()',1000);
    }
    function handleServerResponseDebug(){
  
        if(xmlHttp.readyState==4 && xmlHttp.status==200){
            var data = xmlHttp.responseText;
            var myObj = JSON.parse(data);
            document.getElementById('showtombol').innerHTML=myObj.tombol;
            document.getElementById('detik').innerHTML=myObj.detik;
            
        }
    
    }
    



    function setJws() {
  
        console.log("tombol telah ditekan!");
        var latitude = document.getElementById("latitude").value;
        var longitude = document.getElementById("longitude").value;
        var zonawaktu = document.getElementById("zonawaktu").value;
        var hilal = document.getElementById("hilal").value;
        let ssid = document.getElementById("ssid").value;
        let password = document.getElementById("password").value;
        let batastombol = document.getElementById("batastombol").value;
        
        var dataadmin = {
            latitude:latitude, 
            longitude:longitude, 
            zonawaktu:zonawaktu, 
            hilal:hilal, 
            ssid:ssid, 
            password:password, 
            batastombol:batastombol};
        console.log(dataadmin);
        var xhr = new XMLHttpRequest();
        var url = "/simpandataadmin";
        
        xhr.onreadystatechange = function() {
            if(this.onreadyState == 4  && this.status == 200) {
            console.log(xhr.responseText);
            }
        };
        xhr.open("POST", url, true);
        xhr.send(JSON.stringify(dataadmin));
        
        
    };

    function handleServerResponseDataAdmin(){
  
        if(xmlHttp.readyState==4 && xmlHttp.status==200){
            let data = xmlHttp.responseText;
            console.log(data);
            var myObj = JSON.parse(data);
            document.getElementById('latitude').value=myObj.Latitude;
            document.getElementById('longitude').value=myObj.Longitude;
            document.getElementById('zonawaktu').value=myObj.ZonaWaktu;
            document.getElementById('hilal').value=myObj.Hilal;
            document.getElementById('ssid').value=myObj.ssid;
            document.getElementById('password').value=myObj.password;
            document.getElementById('batastombol').value=myObj.batastombol;

        }
        
    }
</script>
</html>

)=====";
